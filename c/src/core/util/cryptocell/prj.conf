## CMakeLists.txt
```
if (ZEPHYR_BASE)
    zephyr_interface_library_named(cryptocell)
    zephyr_get_include_directories_for_lang_as_string(C includes STRIP_PREFIX)
    zephyr_get_compile_definitions_for_lang_as_string(C definitions)
    zephyr_get_compile_options_for_lang_as_string(C options)
    zephyr_library_include_directories(${includes})
    zephyr_library_compile_definitions(${definitions})
    zephyr_library_include_directories(
        ${PROJECT_SOURCE_DIR}/c/include/in3
        ${PROJECT_SOURCE_DIR}/c/include
    )
    zephyr_library_sources(src/cryptocell.c)
    zephyr_library_link_libraries(cryptocell core crypto init eth_basic cryptocell_signer)
endif()
```

## prj.conf
```kconfig
#
#   Demo application project configuration
#
CONFIG_SOC_SERIES_NRF53X=y
CONFIG_SOC_NRF5340_CPUAPP_QKAA=y
CONFIG_BOARD_NRF5340DK_NRF5340_CPUAPP=y
CONFIG_HW_UNIQUE_KEY=y
CONFIG_HW_UNIQUE_KEY_RANDOM=y
CONFIG_PM_SINGLE_IMAGE=y
CONFIG_MPU_ALLOW_FLASH_WRITE=y
CONFIG_RESET_ON_FATAL_ERROR=y
CONFIG_REBOOT=y
CONFIG_NRF_SECURITY=y
CONFIG_FPU=y
CONFIG_FP_HARDABI=y
CONFIG_NEWLIB_LIBC=y
CONFIG_NEWLIB_LIBC_NANO=n
CONFIG_KERNEL_MEM_POOL=y
CONFIG_HEAP_MEM_POOL_SIZE=8192
CONFIG_MAIN_STACK_SIZE=8192

# Enable nordic security backend and PSA APIs
CONFIG_MBEDTLS_PSA_CRYPTO_C=y
CONFIG_MBEDTLS_ENABLE_HEAP=y
CONFIG_MBEDTLS_HEAP_SIZE=8192

CONFIG_TRUSTED_EXECUTION_SECURE=y
CONFIG_BUILD_WITH_TFM=n

CONFIG_PSA_CRYPTO_DRIVER_OBERON=n
CONFIG_PSA_CRYPTO_DRIVER_CC3XX=y

# Enable logging using RTT and UART
CONFIG_CONSOLE=y
CONFIG_LOG=y
CONFIG_LOG_BACKEND_UART=y
CONFIG_LOG_BUFFER_SIZE=15360
```

## b0.conf
```kconfig
#
#   Demo application bootloader image configuration
#

CONFIG_HW_UNIQUE_KEY_LOAD=y
```

## nrf5340dk_nrf5340_cpuapp.conf
```kconfig
#
#   Demo application: secure application configuration
#

CONFIG_MAIN_STACK_SIZE=8192
CONFIG_HW_UNIQUE_KEY_SRC=y
```

## nrf5340dk_nrf5340_cpuapp_ns.conf
```kconfig
#
#   Demo application: non-secure application configuration
#

CONFIG_TRUSTED_EXECUTION_SECURE=n
CONFIG_BUILD_WITH_TFM=y
CONFIG_TFM_PROFILE_TYPE_NOT_SET=y
```

## include/cryptocell.h
```c
/*******************************************************************************
 * This file is part of the Incubed project.
 * Sources: https://github.com/blockchainsllc/in3
 *
 * Copyright (C) 2018-2020 slock.it GmbH, Blockchains LLC
 *
 *
 * COMMERCIAL LICENSE USAGE
 *
 * Licensees holding a valid commercial license may use this file in accordance
 * with the commercial license agreement provided with the Software or, alternatively,
 * in accordance with the terms contained in a written agreement between you and
 * slock.it GmbH/Blockchains LLC. For licensing terms and conditions or further
 * information please contact slock.it at in3@slock.it.
 *
 * Alternatively, this file may be used under the AGPL license as follows:
 *
 * AGPL LICENSE USAGE
 *
 * This program is free software: you can redistribute it and/or modify it under the
 * terms of the GNU Affero General Public License as published by the Free Software
 * Foundation, either version 3 of the License, or (at your option) any later version.
 *
 * This program is distributed in the hope that it will be useful, but WITHOUT ANY
 * WARRANTY; without even the implied warranty of MERCHANTABILITY or FITNESS FOR A
 * PARTICULAR PURPOSE. See the GNU Affero General Public License for more details.
 * [Permissions of this strong copyleft license are conditioned on making available
 * complete source code of licensed works and modifications, which include larger
 * works using a licensed work, under the same license. Copyright and license notices
 * must be preserved. Contributors provide an express grant of patent rights.]
 * You should have received a copy of the GNU Affero General Public License along
 * with this program. If not, see <https://www.gnu.org/licenses/>.
 *******************************************************************************/
#ifndef CRYPTOCELL_HANDLER_H
#define CRYPTOCELL_HANDLER_H
#ifdef __cplusplus
extern "C" {
#endif
#include <cryptocell_signer.h>
#include <hw_unique_key.h>
#include <nrf_cc3xx_platform_defines.h>
#include <nrf_cc3xx_platform_kmu.h>
#include <psa/crypto.h>
#include <psa/crypto_extra.h>
#include <stdint.h>
#include <stdio.h>
#include <string.h>

#define SUCCESS (0)
#define ERROR   (-1)
#define IV_LEN  12
#define MAC_LEN 16

#define HUK_KEYSLOT                       HUK_KEYSLOT_MKEK
#define PK_RECOVERY_KEY_SLOT              NRF_KMU_LAST_IDENTTY_KEY_SLOT
#define CRYPTOCELL_SIGNER_PK_SLOT         (NRF_KMU_SLOT_KIDENT)
#define CRYPTOCELL_SIGNER_PUBLIC_KEY_SIZE (65)

#define HUK_KEY_SIZE      32
#define IDENTITY_KEY_SIZE 32

/**
 * Attributes setting information for psa crypto operations
 *
 */
typedef struct
{
  psa_algorithm_t    alg;
  psa_key_usage_t    usage_flag;
  psa_key_type_t     alg_type;
  psa_key_lifetime_t lifetime;
  size_t             bits;
} attr_info_t;

typedef enum {
  KEY_TYPE_SYM,
  KEY_TYPE_RSA,
  KEY_TYPE_ECDSA,
  KEY_TYPE_ECDH
} key_type_t;

/**
 *
 *
 */
typedef struct
{
  uint32_t     kmu_slot;
  uint8_t      key_buf[32];
  attr_info_t* psa_attr;
} cryptocell_key_handle_t;

/**
 * @brief
 *
 * @return int
 */
int crypto_init(void);

/**
 * @brief
 *
 * @param key_handle
 * @return int
 */
int crypto_deinit(psa_key_id_t key_handle);

/**
 * @brief
 *
 * @return int
 */
int platform_init(void);

/**
 * @brief
 *
 * @return int
 */
int write_random_key_kmu(void);

/**
 * @brief Set the psa attr object
 *
 * @param attributes
 * @param psa_attr
 */
static psa_key_attributes_t set_psa_attr(key_type_t key_type);

/**
 * @brief
 *
 * @return psa_status_t
 */
psa_status_t
generate_random_vector(void);

/**
 * @brief
 *
 * @param attributes
 * @param key_label
 * @param label_size
 * @return psa_key_id_t
 */
int derive_ek_sym_aes_enc_dec(uint8_t* key_label, uint32_t label_size, uint8_t* key_out);

#if defined(NRF5340_XXAA_APPLICATION)
/**
 * @brief
 *
 * @param slot
 * @param type
 * @param buff
 * @return int
 */
int write_derived_key_kmu(uint32_t slot, nrf_cc3xx_platform_key_type_t type, nrf_cc3xx_platform_key_buff_t buff);
#endif

/**
 * @brief
 *
 * @param slot
 * @param key
 * @return int
 */
int store_pk_identity_keyslot_kmu(uint32_t slot, uint8_t* key);

/**
 * @brief
 *
 * @param slot
 * @param key
 * @return int
 */
int load_pk_identity_keyslot_kmu(uint32_t slot, uint8_t* key);

/**
 * @brief
 *
 * @param key
 * @return int
 */
int destroy_key(uint8_t* key);

/**
 * @brief
 *
 * @param pk_key_buf
 * @param pub_key_buf
 * @return int
 */
int generate_pk_keypair_ecdsa_sha256(uint8_t* pk_key_buf, uint8_t* pub_key_buf);

/**
 * @brief Set the up cryptocell object
 *
 * @param info
 */
int register_cryptocell_cbk(cryptocell_cbks_t* cbks);

/**
 * @brief
 *
 * @param key_pair_handle
 * @param pub_key
 * @param pub_key_size
 * @return int
 */
static int export_public_key_keypair(psa_key_id_t* key_pair_handle, uint8_t* pub_key, size_t pub_key_size);

/**
 * @brief
 *
 * @param slot
 * @return int
 */
int pk_identity_key_is_stored(uint32_t slot);

#ifdef __cplusplus
}
#endif
#endif // CRYPTOCELL_HANDLER_H
```

## src/cryptocell.c
```c
/*******************************************************************************
 * This file is part of the Incubed project.
 * Sources: https://github.com/blockchainsllc/in3
 *
 * Copyright (C) 2018-2020 slock.it GmbH, Blockchains LLC
 *
 *
 * COMMERCIAL LICENSE USAGE
 *
 * Licensees holding a valid commercial license may use this file in accordance
 * with the commercial license agreement provided with the Software or, alternatively,
 * in accordance with the terms contained in a written agreement between you and
 * slock.it GmbH/Blockchains LLC. For licensing terms and conditions or further
 * information please contact slock.it at in3@slock.it.
 *
 * Alternatively, this file may be used under the AGPL license as follows:
 *
 * AGPL LICENSE USAGE
 *
 * This program is free software: you can redistribute it and/or modify it under the
 * terms of the GNU Affero General Public License as published by the Free Software
 * Foundation, either version 3 of the License, or (at your option) any later version.
 *
 * This program is distributed in the hope that it will be useful, but WITHOUT ANY
 * WARRANTY; without even the implied warranty of MERCHANTABILITY or FITNESS FOR A
 * PARTICULAR PURPOSE. See the GNU Affero General Public License for more details.
 * [Permissions of this strong copyleft license are conditioned on making available
 * complete source code of licensed works and modifications, which include larger
 * works using a licensed work, under the same license. Copyright and license notices
 * must be preserved. Contributors provide an express grant of patent rights.]
 * You should have received a copy of the GNU Affero General Public License along
 * with this program. If not, see <https://www.gnu.org/licenses/>.
 *******************************************************************************/
#include "../include/cryptocell.h"
#include <hw_unique_key.h>
#include <identity_key.h>
#include <nrf_cc3xx_platform.h>
#include <nrf_cc3xx_platform_ctr_drbg.h>
#include <nrf_cc3xx_platform_identity_key.h>
#include <nrfx.h>
#include <nrfx_nvmc.h>
#include <zephyr/kernel.h>
#include <zephyr/logging/log.h>
#include <zephyr/sys/__assert.h>
#include <zephyr/sys/util.h>

LOG_MODULE_REGISTER(cryptocell, LOG_LEVEL_DBG);

/** initialize the psa crypto library */
int crypto_init(void) {
  psa_status_t status;
  /* Initialize PSA Crypto */
  status = psa_crypto_init();
  if (status != PSA_SUCCESS) {
    LOG_INF("psa crypto init failed! (Error: %d)", status);
    return status;
  }
  return status;
}

/** de-initialize the psa crypto library */
int crypto_deinit(psa_key_id_t key_handle) {
  psa_status_t status;
  /* Destroy the key handle */
  status = psa_destroy_key(key_handle);
  if (status != PSA_SUCCESS) {
    LOG_INF("psa_destroy_key failed! (Error: %d)", status);
    return status;
  }
  return status;
}

/** nRF platform initialization */
int platform_init(void) {
  int status = SUCCESS;
#if !defined(CONFIG_BUILD_WITH_TFM)
  status = nrf_cc3xx_platform_init();

  if (status != NRF_CC3XX_PLATFORM_SUCCESS) {
    LOG_INF("nrf_cc3xx_platform_init returned error: %d", status);
    return ERROR;
  }
#endif /* !defined(CONFIG_BUILD_WITH_TFM) */
  return status;
}

/** generate random initialization vector */
psa_status_t generate_random_vector(void) {
  psa_status_t status;
  uint8_t      iv[IV_LEN];
  LOG_INF("*** Generating random IV ***");
  status = psa_generate_random(iv, IV_LEN);
  if (status != PSA_SUCCESS) {
    LOG_INF("psa_generate_random returned error: %d", status);
    return status;
  }
  return status;
}

/** generate and write random hardware unique keys including MKEK to KMU */
int write_random_key_kmu(void) {
  int status;

#if !defined(CONFIG_BUILD_WITH_TFM)
  if (!hw_unique_key_are_any_written()) {
    LOG_INF("Writing random keys to KMU");
    hw_unique_key_write_random();
    LOG_INF("Success!");

#if !defined(HUK_HAS_KMU)
    /* Reboot to allow the bootloader to load the key into CryptoCell. */
    sys_reboot(0);
#endif /* !defined(HUK_HAS_KMU) */
    status = SUCCESS;
  }
#endif /* !defined(CONFIG_BUILD_WITH_TFM) */
  return status;
}

/** Set attributes for the storage key */
static psa_key_attributes_t set_psa_attr(key_type_t key_type) {
  /* Configure the key attributes */
  psa_key_attributes_t key_attributes = PSA_KEY_ATTRIBUTES_INIT;
  switch (key_type) {
    case KEY_TYPE_SYM: {
      /* Configure the key attributes for Symmetric key type */
      psa_set_key_usage_flags(&key_attributes,
                              (PSA_KEY_USAGE_ENCRYPT | PSA_KEY_USAGE_DECRYPT));
      psa_set_key_algorithm(&key_attributes, PSA_ALG_GCM);
      psa_set_key_type(&key_attributes, PSA_KEY_TYPE_AES);
      psa_set_key_bits(&key_attributes, PSA_BYTES_TO_BITS(HUK_SIZE_BYTES));
    } break;
    case KEY_TYPE_RSA:
      break;
    case KEY_TYPE_ECDSA: {
      /* Configure the key attributes for Curve type secp256k1
       * This key needs to be exported from the volatile storage
       */
      psa_set_key_usage_flags(&key_attributes, PSA_KEY_USAGE_SIGN_HASH | PSA_KEY_USAGE_VERIFY_HASH | PSA_KEY_USAGE_EXPORT);
      psa_set_key_lifetime(&key_attributes, PSA_KEY_LIFETIME_VOLATILE);
      psa_set_key_algorithm(&key_attributes, PSA_ALG_ECDSA(PSA_ALG_SHA_256));
      psa_set_key_type(&key_attributes, PSA_KEY_TYPE_ECC_KEY_PAIR(PSA_ECC_FAMILY_SECP_K1));
      psa_set_key_bits(&key_attributes, IDENTITY_KEY_SIZE_BYTES * 8);
    } break;
    case KEY_TYPE_ECDH:
      break;
    default:
      break;
  }
  return key_attributes;
}

/** derive an encryption key out of MKEK HUK */
int derive_ek_sym_aes_enc_dec(uint8_t* key_label, uint32_t label_size, uint8_t* key_out) {
  int          res = SUCCESS;
  psa_status_t status;

  // initialize psa cryptographic library
  status = crypto_init();
  if (status != PSA_SUCCESS) {
    LOG_INF("psa crypto initialization failed");
    res = ERROR;
    return res;
  }

  // Set PSA attributes for key generation
  psa_key_attributes_t key_attributes = set_psa_attr(KEY_TYPE_SYM);
  psa_key_id_t         key_id_out     = 0;
  static uint8_t       ek_out[HUK_SIZE_BYTES];
  // derive an encryption key using the random HUK available in the MKEK slot
  int result = hw_unique_key_derive_key(HUK_KEYSLOT, NULL, 0,
                                        key_label, label_size, ek_out, sizeof(ek_out));
  if (result != 0) {
    LOG_INF("hw_unique_key_derive_key returned error: %d", result);
    res = ERROR;
    return res;
  }

  /** Importing the key into PSA crypto. */
  status = psa_import_key(&key_attributes, ek_out, sizeof(ek_out), &key_id_out);
  if (status != PSA_SUCCESS) {
    LOG_INF("psa_import_key returned error: %d", status);
    res = ERROR;
    return res;
  }
  LOG_HEXDUMP_INF(ek_out, sizeof(ek_out), "Encryption Key");
  LOG_INF("Key handle: 0x%x", key_id_out);

  /* After the key handle is acquired the attributes are not needed */
  psa_reset_key_attributes(&key_attributes);
  return res;
}

#if defined(NRF5340_XXAA_APPLICATION)
/** write derived key to KMU slot */
int write_derived_key_kmu(uint32_t slot, nrf_cc3xx_platform_key_type_t type, nrf_cc3xx_platform_key_buff_t buff) {
  int status;
  status = nrf_cc3xx_platform_kmu_write_key(slot, type, buff);
  if (status != NRF_CC3XX_PLATFORM_SUCCESS) {
    LOG_INF("key write to kmu slot returned with error: %d", status);
  }
  return status;
}
#endif

/** write the generated identity key to KMU slot */
int store_pk_identity_keyslot_kmu(uint32_t slot, uint8_t* key) {
  int status = ERROR;
  /* MKEK is required to encrypt the key before storing it in the KMU slot*/
  if (!hw_unique_key_is_written(HUK_KEYSLOT_MKEK)) {
    LOG_INF("Could not find the MKEK!");
    return -ERR_HUK_MISSING;
  }
  if (slot < NRF_KMU_LAST_IDENTTY_KEY_SLOT && slot >= NRF_KMU_SLOT_KIDENT) {
    if (!nrf_cc3xx_platform_identity_key_is_stored(slot)) {
      // TODO: Need to handle the recovery key check before store any new key on the recovery key slot(uses last KMU slot)
      status = nrf_cc3xx_platform_identity_key_store(slot, key);
      if (status == NRF_CC3XX_PLATFORM_SUCCESS) {
        LOG_INF("Identity key stored from local memory to kmu slot %d", slot);
        status = SUCCESS;
      }
      return status;
    }
  }
  return status;
}

/** check whether identity key slot is written with any secret key */
int pk_identity_key_is_stored(uint32_t slot) {
  if (slot < NRF_KMU_LAST_IDENTTY_KEY_SLOT && slot >= NRF_KMU_SLOT_KIDENT) {
    /* check if any identity key is already stored in the given KMU slot */
    if (nrf_cc3xx_platform_identity_key_is_stored(slot)) {
      return SUCCESS;
    }
  }
  return ERROR;
}

/** retrieve the identity key to KMU slot */
int load_pk_identity_keyslot_kmu(uint32_t slot, uint8_t* key) {
  int status = ERROR;
  /* MKEK is required to retrieve the key by decrypting it before reading from the KMU slot*/
  if (!hw_unique_key_is_written(HUK_KEYSLOT_MKEK)) {
    LOG_INF("Could not find the MKEK!");
    return -ERR_HUK_MISSING;
  }
  if (slot < NRF_KMU_LAST_IDENTTY_KEY_SLOT && slot >= NRF_KMU_SLOT_KIDENT) {
    /* check if any identity key is already stored in the given KMU slot */
    if (nrf_cc3xx_platform_identity_key_is_stored(slot)) {
      /* retreive the identity key from the key slot reserved for identity keys */
      status = nrf_cc3xx_platform_identity_key_retrieve(slot, key);
      if (status == NRF_CC3XX_PLATFORM_SUCCESS) {
        LOG_INF("Private Key loaded to local memory from kmu slot %d ", slot);
        status = SUCCESS;
      }
    }
  }
  // initialize psa cryptographic library
  status = crypto_init();
  if (status != PSA_SUCCESS) {
    LOG_INF("psa crypto initialization failed");
    return ERROR;
  }

  // Set PSA attributes for key generation for the given key type
  psa_key_attributes_t key_attributes = set_psa_attr(KEY_TYPE_ECDSA);

  psa_key_id_t key_id_out = 0;
  uint8_t      pub_key[CRYPTOCELL_SIGNER_PUBLIC_KEY_SIZE];
  size_t       exp_key_len;
  LOG_INF("Importing the identity key into PSA crypto.");
  status = psa_import_key(&key_attributes, key, IDENTITY_KEY_SIZE_BYTES, &key_id_out);
  if (status != PSA_SUCCESS) {
    LOG_INF("psa_import_key failed! (Error: %d). Exiting!", status);
    return ERROR;
  }
  LOG_INF("Exporting the public key corresponding to the identity key.");
  status = psa_export_public_key(key_id_out, pub_key, sizeof(pub_key), &exp_key_len);
  if (status != PSA_SUCCESS) {
    LOG_INF("psa_export_public_key failed! (Error: %d). Exiting!", status);
    return ERROR;
  }
  if (exp_key_len != sizeof(pub_key)) {
    LOG_INF("Output length is invalid! (Expected %d, got %d). Exiting!", sizeof(pub_key), exp_key_len);
    return ERROR;
  }
  LOG_HEXDUMP_INF(pub_key, CRYPTOCELL_SIGNER_PUBLIC_KEY_SIZE, "Exported Public Key");
  return status;
}

/** export the public key corresponding to the generated identity key */
static int export_public_key_keypair(psa_key_id_t* key_pair_handle, uint8_t* pub_key, size_t pub_key_size) {
  size_t exp_key_len;
  LOG_INF("Exporting the public key corresponding to the identity key.");
  psa_status_t status = psa_export_public_key(key_pair_handle, pub_key, pub_key_size, exp_key_len);
  if (status != PSA_SUCCESS) {
    LOG_INF("psa_export_public_key failed! (Error: %d). Exiting!", status);
    return ERROR;
  }
  if (exp_key_len != pub_key_size) {
    LOG_INF("Output length is invalid! (Expected %d, got %d). Exiting!", pub_key_size, exp_key_len);
    return ERROR;
  }
  LOG_HEXDUMP_INF(pub_key, pub_key_size, "Exported Public Key");
  return SUCCESS;
}

/** destroy the key from the local memory for security purpose */
int destroy_key(uint8_t* key) {
  if (key != NULL) {
    nrf_cc3xx_platform_identity_key_free(key);
    return SUCCESS;
  }
  return ERROR;
}

/** destroy key handle */
int destroy_key_handle(psa_key_id_t key_handle) {
  psa_status_t status = psa_destroy_key(key_handle);
  if (status != PSA_SUCCESS) {
    LOG_INF("psa_destroy_key failed! Error: %d", status);
    return ERROR;
  }
  return SUCCESS;
}

/** generate random private key */
int generate_pk_keypair_ecdsa_sha256(uint8_t* pk_key_buf, uint8_t* pub_key_buf) {
  int          res = SUCCESS;
  psa_status_t status;
  size_t       key_len;

  // initialize psa cryptographic library
  status = crypto_init();
  if (status != PSA_SUCCESS) {
    LOG_INF("psa crypto initialization failed");
    return ERROR;
  }

  // Set PSA attributes for key generation for the given key type
  psa_key_attributes_t key_attributes = set_psa_attr(KEY_TYPE_ECDSA);
  psa_key_id_t         key_id_out     = 0;
  status                              = psa_generate_key(&key_attributes, &key_id_out);
  if (status != PSA_SUCCESS) {
    LOG_INF("psa_generate_key failed! Error: %d", status);
    return ERROR;
  }

  status = psa_export_key(key_id_out, pk_key_buf, IDENTITY_KEY_SIZE_BYTES, &key_len);
  if (status != PSA_SUCCESS) {
    LOG_INF("psa_export_key failed! Error: %d", status);
    return ERROR;
  }

  /* After the key handle is acquired the attributes are not needed */
  psa_reset_key_attributes(&key_attributes);

  return res;
}

/** set the cryptocell signer configuration informations */
int register_cryptocell_cbk(cryptocell_cbks_t* cbks) {
  if (cbks) {
    cbks->gen_pk_func = generate_pk_keypair_ecdsa_sha256;
    cbks->str_pk_func = store_pk_identity_keyslot_kmu;
    cbks->ld_pk_func  = load_pk_identity_keyslot_kmu;
    cbks->des_pk_func = destroy_key;
    return SUCCESS;
  }
  return ERROR;
}
```

## src/cryptocell_oberon.c
```c
/*******************************************************************************
 * This file is part of the Incubed project.
 * Sources: https://github.com/blockchainsllc/in3
 *
 * Copyright (C) 2018-2020 slock.it GmbH, Blockchains LLC
 *
 *
 * COMMERCIAL LICENSE USAGE
 *
 * Licensees holding a valid commercial license may use this file in accordance
 * with the commercial license agreement provided with the Software or, alternatively,
 * in accordance with the terms contained in a written agreement between you and
 * slock.it GmbH/Blockchains LLC. For licensing terms and conditions or further
 * information please contact slock.it at in3@slock.it.
 *
 * Alternatively, this file may be used under the AGPL license as follows:
 *
 * AGPL LICENSE USAGE
 *
 * This program is free software: you can redistribute it and/or modify it under the
 * terms of the GNU Affero General Public License as published by the Free Software
 * Foundation, either version 3 of the License, or (at your option) any later version.
 *
 * This program is distributed in the hope that it will be useful, but WITHOUT ANY
 * WARRANTY; without even the implied warranty of MERCHANTABILITY or FITNESS FOR A
 * PARTICULAR PURPOSE. See the GNU Affero General Public License for more details.
 * [Permissions of this strong copyleft license are conditioned on making available
 * complete source code of licensed works and modifications, which include larger
 * works using a licensed work, under the same license. Copyright and license notices
 * must be preserved. Contributors provide an express grant of patent rights.]
 * You should have received a copy of the GNU Affero General Public License along
 * with this program. If not, see <https://www.gnu.org/licenses/>.
 *******************************************************************************/
#ifdef CRYPTOCELL_OBERON
#include "crypto.h"
#include <ocrypto_curve_p256.h>
#include <ocrypto_ecdsa_p256.h>
#include <ocrypto_sha256.h>
#include <pthread.h>
#include <stdint.h>
#include <stdlib.h>
#include <string.h>
#include <time.h>

/** create a digest based on the type passed */
in3_digest_t crypto_create_hash(
    in3_digest_type_t type /**< the type as defined in in3_digest_type_t*/
) {
  in3_digest_t digest = {.ctx = NULL, .type = type};
  switch (type) {
    case DIGEST_SHA256:
    case DIGEST_SHA256_BTC: {
      digest.ctx = _calloc(1, sizeof(ocrypto_sha256_ctx));
      ocrypto_sha256_init((ocrypto_sha256_ctx*) digest.ctx); /**< generator state is initialized */
      return digest;
    }
    default: return digest;
  }
}

/** updates the hash with the passed bytes */
void crypto_update_hash(
    in3_digest_t digest, /**< the digest created with crypto_create_hash */
    bytes_t      data    /**< the data to hash */
) {
  switch (digest.type) {
    case DIGEST_SHA256:
    case DIGEST_SHA256_BTC: {
      if (data.len) ocrypto_sha256_update(digest.ctx, data.data, data.len); /**< generator state is updated to hash a message chunk */
      return;
    }
    default: return;
  }
}

/** finishes the hash and writes the result to the given pointer. This function will also clean up all resources used during hashing */
void crypto_finalize_hash(
    in3_digest_t digest, /**< the digest created with crypto_create_hash */
    void*        dst     /**< pointer to the data to write the final hash. the size depends on the diget type */
) {
  if (dst && digest.ctx) {
    switch (digest.type) {
      case DIGEST_SHA256:
      case DIGEST_SHA256_BTC: {
        if (digest.type == DIGEST_SHA256_BTC) {
          bytes32_t tmp;
          ocrypto_sha256_final(digest.ctx, tmp);
          ocrypto_sha256_init(digest.ctx);
          ocrypto_sha256_update(digest.ctx, tmp, 32);
        }
        ocrypto_sha256_final(digest.ctx, dst); /**< generator state is updated to final hash for the message chunk */
        break;
      }
      default: break;
    }
  }
  _free(digest.ctx);
}

static in3_ret_t crypto_pk_to_public_key(
    in3_curve_type_t type,  /**<  type of elliptic curve algorithm */
    const uint8_t*   pk,    /**<  secret key */
    uint8_t*         pubkey /**<  generated pbulickey */
) {
  in3_ret_t res = IN3_OK;
  switch (type) {
    case ECDSA_SECP256R1: {
      res = (ocrypto_ecdsa_p256_public_key(pubkey, pk) < 0 ? IN3_EINVAL : IN3_OK); /**<  public key is computed using the ecdsa secp256r1 digital signature scheme */
      return res;
    }
    case EDDSA_ED25519: {
      ocrypto_ed25519_public_key(pubkey, pk); /**<  public key is computed using the eddsa  digital signature scheme */
      return IN3_OK;
    }
    case ECDH_SECP256R1: {
      res = (ocrypto_ecdh_p256_public_key(pubkey, pk) < 0 ? IN3_EINVAL : IN3_OK); /**<  public key is computed using the eddsa  digital signature scheme */
      return res;
    }
    default: return IN3_ENOTSUP;
  }
}

in3_ret_t crypto_sign_digest(
    in3_curve_type_t type,   /**<  type of elliptic curve algorithm */
    const bytes_t    digest, /**<  created hash */
    const uint8_t*   pk,     /**<  secret key */
    const uint8_t*   pubkey, /**<  signers public key */
    uint8_t*         dst     /**<  generated signature */
) {
  switch (type) {
    case ECDSA_SECP256R1: {
      ocrypto_ecdsa_p256_det_sign_hash(dst, digest.data, pk); /**< SHA256 hash digest is signed using secret key and session key generated from hash and key */
      return IN3_OK;
    }
    case EDDSA_ED25519: {
      ocrypto_ed25519_sign(dst, digest.data, digest.len, pk, pubkey); /**< SHA256 hash digest is signed using public key and secret key using ECDSA P-256 signature generation */
      return IN3_OK;
    }
    default: return IN3_ENOTSUP;
  }
}

in3_ret_t crypto_verify_signature(
    in3_curve_type_t type,    /**<  type of elliptic curve algorithm */
    const uint8_t    sig[64], /**<  signature generated */
    const uint8_t*   pubkey,  /**<  signers public key */
    const bytes_t    digest   /**<  input hash */
) {
  in3_ret_t res = IN3_OK;
  switch (type) {
    case ECDSA_SECP256R1: {
      res = ocrypto_ecdsa_p256_verify_hash(sig, digest.data, pubkey); /**< SHA256 hash digest is signed using secret key and session key generated from hash and key */
      return res;
    }
    case EDDSA_ED25519: {
      res = ocrypto_ed25519_verify(sig, digest.data, digest.len, pubkey); /**< SHA256 hash digest is signed using public key and secret key using ECDSA P-256 signature generation */
      return res;
    }
    default: return IN3_ENOTSUP;
  }
}

in3_ret_t crypto_recover(in3_curve_type_t type, const bytes_t digest, bytes_t signature, uint8_t* dst) {
  UNUSED_VAR(type);
  UNUSED_VAR(digest);
  UNUSED_VAR(signature);
  UNUSED_VAR(dst);
  return IN3_ENOTSUP;
}

in3_ret_t crypto_convert(in3_curve_type_t type, in3_convert_type_t conv_type, bytes_t src, uint8_t* dst, int* dst_len) {
  UNUSED_VAR(type);
  UNUSED_VAR(conv_type);
  UNUSED_VAR(src);
  UNUSED_VAR(dst);
  UNUSED_VAR(dst_len);
  return IN3_ENOTSUP;
}

void memzero(void* const pnt, const size_t len) {
  memset(pnt, 0, len);
}
#endif
```

## src/cryptocell_psa.c
```c
/*******************************************************************************
 * This file is part of the Incubed project.
 * Sources: https://github.com/blockchainsllc/in3
 *
 * Copyright (C) 2018-2020 slock.it GmbH, Blockchains LLC
 *
 *
 * COMMERCIAL LICENSE USAGE
 *
 * Licensees holding a valid commercial license may use this file in accordance
 * with the commercial license agreement provided with the Software or, alternatively,
 * in accordance with the terms contained in a written agreement between you and
 * slock.it GmbH/Blockchains LLC. For licensing terms and conditions or further
 * information please contact slock.it at in3@slock.it.
 *
 * Alternatively, this file may be used under the AGPL license as follows:
 *
 * AGPL LICENSE USAGE
 *
 * This program is free software: you can redistribute it and/or modify it under the
 * terms of the GNU Affero General Public License as published by the Free Software
 * Foundation, either version 3 of the License, or (at your option) any later version.
 *
 * This program is distributed in the hope that it will be useful, but WITHOUT ANY
 * WARRANTY; without even the implied warranty of MERCHANTABILITY or FITNESS FOR A
 * PARTICULAR PURPOSE. See the GNU Affero General Public License for more details.
 * [Permissions of this strong copyleft license are conditioned on making available
 * complete source code of licensed works and modifications, which include larger
 * works using a licensed work, under the same license. Copyright and license notices
 * must be preserved. Contributors provide an express grant of patent rights.]
 * You should have received a copy of the GNU Affero General Public License along
 * with this program. If not, see <https://www.gnu.org/licenses/>.
 *******************************************************************************/
#ifdef CRYPTOCELL_PSA

#endif
```
