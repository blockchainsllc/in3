## CMakeLists.txt
```
cmake_minimum_required(VERSION 3.13.1)

include($ENV{ZEPHYR_BASE}/cmake/app/boilerplate.cmake NO_POLICY_SCOPE)
include(../../../macro.cmake)

project(z_in3)

target_sources(app PRIVATE src/main.c)

ADD_DEFINITIONS(-DTEST)
ADD_DEFINITIONS(-DDEBUG)
ADD_DEFINITIONS(-DCRYPTO_TREZOR)
ADD_DEFINITIONS(-DNODESELECT_DEF)
ADD_DEFINITIONS(-DNO_BOOT_NODES_MAINNET)
ADD_DEFINITIONS(-DNO_BOOT_NODES_IPFS)
ADD_DEFINITIONS(-DNO_BOOT_NODES_BTC)
ADD_DEFINITIONS(-DNO_BOOT_NODES_EWC)
ADD_DEFINITIONS(-DUSE_SCRYPT=false)
ADD_DEFINITIONS(-DIN3_EXPORT_TEST=static)
ADD_DEFINITIONS(-DIN3_IMPORT_TEST=)
SET(CMAKE_BUILD_TYPE Debug)
SET(CMAKE_VERBOSE_MAKEFILE ON)
SET(CRYPTO_TREZOR true)
ADD_DEFINITIONS(-DZEPHYR_OS)
ADD_DEFINITIONS(-DZEPHYR)
ADD_DEFINITIONS(-DIN3_MATH_LITE)

set(IN3_SRC ../../..)
set(IN3_DEPS 
${IN3_SRC}/src/core 
${IN3_SRC}/src/verifier/eth1/basic 
${IN3_SRC}/src/verifier/eth1/nano 
${IN3_SRC}/src/signer/pk-signer 
${IN3_SRC}/src/api/eth1
${IN3_SRC}/src/api/utils
${IN3_SRC}/src/third-party/crypto
${IN3_SRC}/src/third-party/tommath
${IN3_SRC}/src/nodeselect/full
)

foreach(dep ${IN3_DEPS})
  file(GLOB files "${dep}/**/*.c")
  file(GLOB files2 "${dep}/*.c")
  #temp fix for building with a GLOB and not include all 3rd party libs
  list(FILTER files EXCLUDE REGEX ".*aestst.c$")
  list(FILTER files EXCLUDE REGEX ".*crypto_none.c$")
  list(FILTER files EXCLUDE REGEX ".*crypto_openssl.c$")
  target_sources(app PRIVATE "${files}" "${files2}")
  include_directories ("${dep}")
endforeach()
target_include_directories (app PRIVATE "../include")
target_include_directories (app PRIVATE "$ENV{ZEPHYR_BASE}/include")
```

## prj.conf
```kconfig
# nothing here
CONFIG_HEAP_MEM_POOL_SIZE=59400
CONFIG_PRINTK=y
CONFIG_MAIN_STACK_SIZE=2084
#CONFIG_ASSERT=y
#CONFIG_DEBUG_OPTIMIZATIONS=y
#SYSTEM_CLOCK_DISABLE=y
```

## src/main.c
```c
/*******************************************************************************
 * This file is part of the Incubed project.
 * Sources: https://github.com/blockchainsllc/in3
 * 
 * Copyright (C) 2018-2020 slock.it GmbH, Blockchains LLC
 * 
 * 
 * COMMERCIAL LICENSE USAGE
 * 
 * Licensees holding a valid commercial license may use this file in accordance 
 * with the commercial license agreement provided with the Software or, alternatively, 
 * in accordance with the terms contained in a written agreement between you and 
 * slock.it GmbH/Blockchains LLC. For licensing terms and conditions or further 
 * information please contact slock.it at in3@slock.it.
 * 	
 * Alternatively, this file may be used under the AGPL license as follows:
 *    
 * AGPL LICENSE USAGE
 * 
 * This program is free software: you can redistribute it and/or modify it under the
 * terms of the GNU Affero General Public License as published by the Free Software 
 * Foundation, either version 3 of the License, or (at your option) any later version.
 *  
 * This program is distributed in the hope that it will be useful, but WITHOUT ANY 
 * WARRANTY; without even the implied warranty of MERCHANTABILITY or FITNESS FOR A 
 * PARTICULAR PURPOSE. See the GNU Affero General Public License for more details.
 * [Permissions of this strong copyleft license are conditioned on making available 
 * complete source code of licensed works and modifications, which include larger 
 * works using a licensed work, under the same license. Copyright and license notices 
 * must be preserved. Contributors provide an express grant of patent rights.]
 * You should have received a copy of the GNU Affero General Public License along 
 * with this program. If not, see <https://www.gnu.org/licenses/>.
 *******************************************************************************/

#include "block_number.h"
#include "client/plugin.h"
#include "eth_api.h"   //wrapper for easier use
#include "eth_basic.h" // the full ethereum verifier containing the EVM
#include "nodeselect_def.h"
#include "receipt.h"
#include "util/log.h"
#include "util/mem.h"
#include "util/stringbuilder.h"


/**
 * In3 Setup and usage
 * **/
/* Perform in3 requests for http transport */
in3_ret_t local_transport_func(char** urls, int urls_len, char* payload, in3_response_t* result) {
  for (int i = 0; i < urls_len; i++) {
    result[i].state = IN3_OK;
    if (strstr(payload, "eth_getTransactionReceipt") != NULL) {
      printk("Returning eth_getTransactionReceipt ...\n");
      sb_add_range(&(result[i].data), mock_tx_receipt, 0, mock_tx_receipt_len);
    }
    else if (strstr(payload, "eth_blockNumber") != NULL) {
      printk("Returning eth_blockNumber ...\n");
      sb_add_range(&(result[i].data), block_number_res, 0, block_number_res_len);
    }
    else {
      in3_log_debug("Not supported for this mock\n");
    }
  }
  return IN3_OK;
}

in3_ret_t transport_mock(void* plugin_data, in3_plugin_act_t action, void* plugin_ctx) {
  in3_http_request_t* req = plugin_ctx;
  return local_transport_func((char**) req->urls, req->urls_len, req->payload, req->req->raw_response);
}

in3_t* init_in3_goerli(in3_plugin_act_fn custom_transport) {
  in3_t* in3 = NULL;
  //int    err;
  in3 = in3_for_chain(0x5);
  in3_register_eth_basic(in3);
  in3_register_nodeselect_def(in3);
  if (custom_transport)
    in3_plugin_register(in3, PLGN_ACT_TRANSPORT, custom_transport, NULL, true);
  in3->flags = FLAGS_STATS | FLAGS_INCLUDE_CODE | FLAGS_BINARY;
  in3_configure(in3, "{\"chainId\":\"0x5\",\"autoUpdateList\":false,\"requestCount\":1,\"maxAttempts\":1,\"nodeRegistry\":{\"needsUpdate\":false}}");
  return in3;
}

//this instruction makes the qemu exit, not in a clean way yet but it works
static inline void _exit_qemu() {
  register uint32_t r0 __asm__("r0");
  r0 = 0x18;
  register uint32_t r1 __asm__("r1");
  r1 = 0x20026;
  __asm__ volatile("bkpt #0xAB");
}

void main() {
  // the hash of transaction whose receipt we want to get
  in3_t*    in3 = init_in3_goerli(transport_mock);
  bytes32_t tx_hash;
  hex_to_bytes("0x8e7fb87e95c69a780490fce3ea14b44c78366fc45baa6cb86a582166c10c6d9d", -1, tx_hash, 32);
  // get the tx receipt by hash
  eth_tx_receipt_t* txr = eth_getTransactionReceipt(in3, tx_hash);
  if (txr && txr->gas_used) {
    printk("status: %d ", txr->status);
    printk("gas: %lld ", txr->gas_used);
    printk("IN3 TEST PASSED OK !\n");
  }
  else {
    printk("IN3 TEST FAILED !\n");
  }
  eth_tx_receipt_free(txr);
  in3_free(in3);
  _exit_qemu();
}
```

## src/receipt.h
```c
// Imported from file 'receipt.bin'
const unsigned char mock_tx_receipt[] = {
	0xdc,0x25,0x41,0x64,0xb6,0xf9,0x23,0x32,0x2e,0x30,0x00,0xb6,0x89,0x6c,0x9a,0x5b,0x1c,0x20,0x1c,0x9d,0x59,0x2c,0x4a,0xd3,0xfb,0xa0,0x2f,0x7a,0xa0,0x63,
	0xe8,0x04,0x8b,0x3f,0xf1,0x25,0x51,0xfd,0x37,0x7e,0x78,0x06,0x1a,0xb6,0xad,0x14,0x6c,0xc8,0xdf,0x4d,0x64,0xca,0xbe,0x17,0xa7,0xa4,0xf5,0xc4,0xc0,0x5e,
	0x7f,0xbe,0x01,0x0d,0x16,0x04,0x96,0x14,0x19,0x29,0xc1,0x5f,0x4e,0x81,0x8a,0xbf,0x25,0x49,0x51,0x06,0x22,0xa5,0x0c,0x44,0x0c,0x47,0x42,0x23,0x68,0xd2,
	0xbd,0x69,0x3f,0xc5,0x97,0x40,0xcf,0xd4,0x1d,0x01,0x00,0x00,0x00,0x00,0x00,0x00,0x00,0x00,0x00,0x00,0x00,0x00,0x00,0x00,0x00,0x00,0x00,0x00,0x00,0x00,
	0x00,0x00,0x00,0x00,0x00,0x00,0x00,0x00,0x00,0x00,0x00,0x00,0x00,0x00,0x00,0x00,0x00,0x00,0x00,0x00,0x00,0x00,0x00,0x00,0x00,0x00,0x00,0x00,0x00,0x00,
	0x00,0x00,0x00,0x00,0x00,0x00,0x00,0x00,0x00,0x00,0x00,0x00,0x00,0x00,0x00,0x00,0x00,0x00,0x00,0x00,0x00,0x00,0x00,0x00,0x00,0x00,0x00,0x00,0x00,0x00,
	0x00,0x00,0x00,0x00,0x00,0x00,0x00,0x00,0x00,0x00,0x00,0x00,0x00,0x00,0x00,0x00,0x00,0x00,0x00,0x00,0x00,0x00,0x00,0x00,0x00,0x00,0x00,0x00,0x00,0x00,
	0x00,0x00,0x00,0x00,0x00,0x00,0x00,0x00,0x00,0x00,0x00,0x00,0x00,0x00,0x00,0x00,0x00,0x00,0x00,0x00,0x00,0x00,0x00,0x00,0x00,0x00,0x00,0x00,0x00,0x00,
	0x00,0x00,0x00,0x00,0x00,0x00,0x00,0x00,0x00,0x00,0x00,0x00,0x00,0x00,0x00,0x00,0x00,0x00,0x00,0x00,0x00,0x00,0x00,0x00,0x00,0x00,0x00,0x00,0x00,0x00,
	0x00,0x00,0x00,0x00,0x00,0x00,0x00,0x00,0x00,0x00,0x00,0x00,0x00,0x00,0x00,0x00,0x00,0x00,0x00,0x00,0x00,0x00,0x00,0x00,0x00,0x00,0x00,0x00,0x00,0x00,
	0x00,0x00,0x00,0x00,0x00,0x00,0x00,0x00,0x00,0x00,0x00,0x00,0x00,0x00,0x00,0x00,0x00,0x00,0x00,0x00,0x00,0x00,0x00,0x00,0x00,0x00,0x00,0x00,0x00,0x00,
	0x00,0x00,0x00,0x00,0x00,0x00,0x00,0x00,0x00,0x00,0x00,0x00,0x00,0x00,0x00,0x00,0x00,0x00,0x00,0x00,0x00,0x00,0x00,0x00,0x00,0x00,0x00,0x73,0x94,0xa1,
	0x3a,0x1b,0x14,0xf7,0xc8,0xc3,0xb2,0x6b,0x89,0x58,0xa8,0x83,0x4a,0xc7,0xbd,0xa5,0x40,0xef,0x55,0x2f,0x13,0x51,0x50,0x6e,0xd6,0x1c,0x20,0x8e,0x7f,0xb8,
	0x7e,0x95,0xc6,0x9a,0x78,0x04,0x90,0xfc,0xe3,0xea,0x14,0xb4,0x4c,0x78,0x36,0x6f,0xc4,0x5b,0xaa,0x6c,0xb8,0x6a,0x58,0x21,0x66,0xc1,0x0c,0x6d,0x9d,0x04,
	0xba,0xa1,0x34,0x8d,0xa1,0x77,0x34,0x68,0x4e,0xe4,0x67,0x42,0x18,0x2c,0x72,0x65,0x63,0x65,0x69,0x70,0x74,0x50,0x72,0x6f,0x6f,0x66,0x00,0xc7,0xe9,0x1d,
	0x02,0x5f,0xf9,0x02,0x5c,0xa0,0x9c,0xd2,0x2d,0x20,0x9f,0x24,0x34,0x41,0x47,0x49,0x4d,0x05,0xd1,0x3f,0x33,0x5b,0x6e,0x63,0xaf,0x93,0x0a,0xbd,0xc6,0x0f,
	0x3d,0xb6,0x36,0x27,0x58,0x9e,0x14,0x38,0xa0,0x1d,0xcc,0x4d,0xe8,0xde,0xc7,0x5d,0x7a,0xab,0x85,0xb5,0x67,0xb6,0xcc,0xd4,0x1a,0xd3,0x12,0x45,0x1b,0x94,
	0x8a,0x74,0x13,0xf0,0xa1,0x42,0xfd,0x40,0xd4,0x93,0x47,0x94,0x00,0x00,0x00,0x00,0x00,0x00,0x00,0x00,0x00,0x00,0x00,0x00,0x00,0x00,0x00,0x00,0x00,0x00,
	0x00,0x00,0xa0,0x8e,0xef,0x75,0x82,0x04,0x88,0xf6,0xee,0x9f,0xf2,0x3b,0x41,0x98,0x3b,0x4a,0x62,0x9f,0xb2,0x92,0x9c,0xa7,0xf6,0xa7,0x96,0x05,0xf1,0xea,
	0x23,0xf3,0x92,0xc5,0xe4,0xa0,0xe9,0x29,0x31,0x82,0x30,0x6e,0x29,0xfe,0xd2,0xde,0xb3,0xb0,0x80,0x94,0x53,0x0a,0xa8,0x1f,0xf3,0x0c,0xb8,0xe5,0x5d,0xd1,
	0xdc,0x42,0xaf,0xb5,0x0d,0xfd,0x1f,0x88,0xa0,0x9b,0x2e,0xb5,0x94,0xe0,0x36,0x3e,0xd0,0x48,0x7f,0xbb,0x7e,0x51,0x60,0x64,0x36,0xde,0x95,0xf5,0x83,0x6f,
	0x2b,0xf1,0xc5,0x20,0xfb,0x34,0x4b,0xcf,0x5d,0x21,0x02,0xb9,0x01,0x00,0x00,0x00,0x00,0x00,0x00,0x00,0x00,0x00,0x00,0x00,0x00,0x00,0x00,0x00,0x00,0x00,
	0x00,0x00,0x00,0x00,0x00,0x00,0x00,0x00,0x00,0x00,0x00,0x00,0x00,0x00,0x00,0x00,0x00,0x00,0x00,0x00,0x00,0x00,0x00,0x00,0x00,0x00,0x00,0x00,0x00,0x00,
	0x00,0x00,0x00,0x00,0x00,0x00,0x00,0x00,0x00,0x00,0x00,0x00,0x00,0x00,0x00,0x00,0x00,0x00,0x00,0x00,0x00,0x00,0x00,0x00,0x00,0x00,0x00,0x00,0x00,0x00,
	0x00,0x00,0x00,0x00,0x00,0x00,0x00,0x00,0x00,0x00,0x00,0x00,0x00,0x00,0x00,0x00,0x00,0x00,0x00,0x00,0x00,0x00,0x00,0x00,0x00,0x00,0x00,0x00,0x00,0x00,
	0x00,0x00,0x00,0x00,0x00,0x00,0x00,0x00,0x00,0x00,0x00,0x00,0x00,0x00,0x00,0x00,0x00,0x00,0x00,0x00,0x00,0x00,0x00,0x00,0x00,0x00,0x00,0x00,0x00,0x00,
	0x00,0x00,0x00,0x00,0x00,0x00,0x00,0x00,0x00,0x00,0x00,0x00,0x00,0x00,0x00,0x00,0x00,0x00,0x00,0x00,0x00,0x00,0x00,0x00,0x00,0x00,0x00,0x00,0x00,0x00,
	0x00,0x00,0x00,0x00,0x00,0x00,0x00,0x00,0x00,0x00,0x00,0x00,0x00,0x00,0x00,0x00,0x00,0x00,0x00,0x00,0x00,0x00,0x00,0x00,0x00,0x00,0x00,0x00,0x00,0x00,
	0x00,0x00,0x00,0x00,0x00,0x00,0x00,0x00,0x00,0x00,0x00,0x00,0x00,0x00,0x00,0x00,0x00,0x00,0x00,0x00,0x00,0x00,0x00,0x00,0x00,0x00,0x00,0x00,0x00,0x00,
	0x00,0x00,0x00,0x00,0x00,0x00,0x00,0x00,0x00,0x00,0x00,0x00,0x00,0x00,0x00,0x00,0x00,0x00,0x00,0x00,0x00,0x00,0x00,0x00,0x00,0x00,0x00,0x00,0x00,0x00,
	0x01,0x83,0x17,0xa7,0xa4,0x83,0x7a,0x12,0x00,0x83,0x01,0x0d,0x16,0x84,0x5d,0xb6,0xf9,0x5b,0xb8,0x61,0xd8,0x83,0x01,0x09,0x03,0x84,0x67,0x65,0x74,0x68,
	0x88,0x67,0x6f,0x31,0x2e,0x31,0x32,0x2e,0x39,0x85,0x6c,0x69,0x6e,0x75,0x78,0x00,0x00,0x00,0x00,0x00,0x00,0x00,0x9e,0x58,0x9a,0x28,0x29,0xf6,0xfe,0x4b,
	0x72,0xd4,0xff,0x51,0x1f,0xda,0xa4,0x64,0xa9,0xa8,0xcf,0x16,0xcd,0x10,0x40,0x81,0x38,0x1d,0xe0,0x2d,0xfd,0xff,0x0f,0xaf,0x59,0xdc,0xd0,0x8d,0xff,0xa6,
	0x74,0x91,0x01,0x84,0x93,0x71,0x0b,0x2a,0x48,0x74,0xbb,0x54,0x7a,0x09,0xd1,0x38,0x27,0xd5,0xe3,0x2f,0x2b,0xf2,0x82,0x38,0x5c,0x80,0x00,0xa0,0x00,0x00,
	0x00,0x00,0x00,0x00,0x00,0x00,0x00,0x00,0x00,0x00,0x00,0x00,0x00,0x00,0x00,0x00,0x00,0x00,0x00,0x00,0x00,0x00,0x00,0x00,0x00,0x00,0x00,0x00,0x00,0x00,
	0x88,0x00,0x00,0x00,0x00,0x00,0x00,0x00,0x00,0x72,0xc8,0x42,0x1c,0x53,0xf8,0x51,0xa0,0xa1,0x7d,0xf2,0x72,0x66,0x01,0x9f,0x80,0x99,0xd5,0xb0,0xd7,0xcb,
	0x07,0x5a,0xe5,0x07,0x3c,0x46,0xb4,0x9f,0x78,0xeb,0x30,0xbd,0xcc,0xe5,0xa3,0xe5,0xaf,0xe1,0xdd,0x80,0x80,0x80,0x80,0x80,0x80,0x80,0xa0,0xe9,0xc1,0x17,
	0xde,0x30,0x4d,0x23,0x05,0x0c,0xcc,0x6a,0x30,0xd2,0xab,0x00,0x9a,0x34,0x5b,0x18,0xac,0x1a,0x31,0xdb,0x0d,0x36,0xcf,0x86,0xa1,0xd0,0x25,0xfe,0x93,0x80,
	0x80,0x80,0x80,0x80,0x80,0x80,0x80,0x1c,0x8f,0xf8,0x8d,0x31,0xb8,0x8a,0xf8,0x88,0x32,0x85,0x04,0xa8,0x17,0xc8,0x00,0x82,0xa3,0xd7,0x94,0xf7,0xc8,0xc3,
	0xb2,0x6b,0x89,0x58,0xa8,0x83,0x4a,0xc7,0xbd,0xa5,0x40,0xef,0x55,0x2f,0x13,0x51,0x50,0x80,0xa4,0x59,0xce,0x7d,0x4c,0x00,0x00,0x00,0x00,0x00,0x00,0x00,
	0x00,0x00,0x00,0x00,0x00,0x00,0x00,0x00,0x00,0x00,0x00,0x00,0x00,0x00,0x00,0x00,0x00,0x00,0x00,0x00,0x00,0x00,0x00,0x00,0x01,0x2e,0xa0,0xb9,0x51,0xcc,
	0x1b,0xd2,0x3c,0x76,0x79,0x23,0x7b,0xa7,0x19,0xc2,0x5a,0xe9,0x76,0xe1,0x27,0xd5,0xfa,0xf6,0x8a,0x79,0x79,0x95,0x8d,0x5c,0xa4,0x78,0xe3,0xf5,0x25,0xa0,
	0x4e,0x37,0x8e,0x47,0xec,0xcb,0xa2,0xe0,0x28,0x6c,0x9b,0xc6,0x24,0xad,0xe7,0x7c,0xa7,0x6e,0x8d,0xca,0x4a,0x9d,0x5a,0xc0,0x91,0xff,0xa9,0x30,0x90,0x7c,
	0x09,0x39,0xfb,0x5c,0x42,0x1c,0x53,0xf8,0x51,0xa0,0x3f,0xac,0x69,0x22,0x29,0xde,0x62,0xb0,0x61,0xff,0xe3,0x97,0x55,0xa7,0x18,0x36,0xe9,0x11,0x2c,0x77,
	0xb8,0x86,0x73,0x9d,0xa4,0xeb,0x76,0xc8,0x25,0xdf,0xf1,0xbc,0x80,0x80,0x80,0x80,0x80,0x80,0x80,0xa0,0x4a,0x74,0x08,0x27,0xb8,0xda,0x89,0x4c,0x04,0x66,
	0x90,0x00,0x94,0x7e,0x5b,0xc7,0x24,0x7c,0x88,0x41,0x2e,0xb1,0x6a,0xc1,0x31,0xdc,0xfc,0xaa,0xbf,0x28,0xcf,0xf8,0x80,0x80,0x80,0x80,0x80,0x80,0x80,0x80,
	0x1d,0x01,0x13,0xf9,0x01,0x10,0x31,0xb9,0x01,0x0c,0xf9,0x01,0x09,0x01,0x83,0x01,0x0d,0x16,0xb9,0x01,0x00,0x00,0x00,0x00,0x00,0x00,0x00,0x00,0x00,0x00,
	0x00,0x00,0x00,0x00,0x00,0x00,0x00,0x00,0x00,0x00,0x00,0x00,0x00,0x00,0x00,0x00,0x00,0x00,0x00,0x00,0x00,0x00,0x00,0x00,0x00,0x00,0x00,0x00,0x00,0x00,
	0x00,0x00,0x00,0x00,0x00,0x00,0x00,0x00,0x00,0x00,0x00,0x00,0x00,0x00,0x00,0x00,0x00,0x00,0x00,0x00,0x00,0x00,0x00,0x00,0x00,0x00,0x00,0x00,0x00,0x00,
	0x00,0x00,0x00,0x00,0x00,0x00,0x00,0x00,0x00,0x00,0x00,0x00,0x00,0x00,0x00,0x00,0x00,0x00,0x00,0x00,0x00,0x00,0x00,0x00,0x00,0x00,0x00,0x00,0x00,0x00,
	0x00,0x00,0x00,0x00,0x00,0x00,0x00,0x00,0x00,0x00,0x00,0x00,0x00,0x00,0x00,0x00,0x00,0x00,0x00,0x00,0x00,0x00,0x00,0x00,0x00,0x00,0x00,0x00,0x00,0x00,
	0x00,0x00,0x00,0x00,0x00,0x00,0x00,0x00,0x00,0x00,0x00,0x00,0x00,0x00,0x00,0x00,0x00,0x00,0x00,0x00,0x00,0x00,0x00,0x00,0x00,0x00,0x00,0x00,0x00,0x00,
	0x00,0x00,0x00,0x00,0x00,0x00,0x00,0x00,0x00,0x00,0x00,0x00,0x00,0x00,0x00,0x00,0x00,0x00,0x00,0x00,0x00,0x00,0x00,0x00,0x00,0x00,0x00,0x00,0x00,0x00,
	0x00,0x00,0x00,0x00,0x00,0x00,0x00,0x00,0x00,0x00,0x00,0x00,0x00,0x00,0x00,0x00,0x00,0x00,0x00,0x00,0x00,0x00,0x00,0x00,0x00,0x00,0x00,0x00,0x00,0x00,
	0x00,0x00,0x00,0x00,0x00,0x00,0x00,0x00,0x00,0x00,0x00,0x00,0x00,0x00,0x00,0x00,0x00,0x00,0x00,0x00,0x00,0x00,0x00,0x00,0x00,0x00,0x00,0x00,0x00,0x00,
	0x00,0x00,0x00,0x00,0x00,0x00,0x00,0xc0,0xb9,0xd2,0xa1,0xb2,0x97,0x40,0x61,0xed,0x80,0x3c,0xfa,0x25,0x32,0x2e,0x31,0x2e,0x30,0x00,0x87,0xa0,0xbe,0x20,
	0x81,0x38,0x6b,0x72,0xa0,0x45,0x08,0xbe,0x1f,0xe8,0x09,0x1c,0xae,0xbd,0x02,0x59,0xe4,0xd4,0xbd,0x02,0x4e,0x08,0x22,0xa3
};
const unsigned int mock_tx_receipt_len = 1704;
```
