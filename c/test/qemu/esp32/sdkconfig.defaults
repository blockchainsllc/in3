## c/test/qemu/esp32/sdkconfig.defaults
```kconfig
CONFIG_WIFI_SSID="GL-AR150-871"
CONFIG_WIFI_PASSWORD="M4y41219"
CONFIG_PARTITION_TABLE_CUSTOM=y
CONFIG_PARTITION_TABLE_CUSTOM_FILENAME="partitions.csv"
CONFIG_PARTITION_TABLE_FILENAME="partitions.csv"
CONFIG_HEAP_ABORT_WHEN_ALLOCATION_FAILS=y
CONFIG_ESP_MAIN_TASK_STACK_SIZE=72584
CONFIG_HEAP_POISONING_COMPREHENSIVE=y
CONFIG_HEAP_TRACING_STANDALONE=y
CONFIG_HEAP_TRACING=y
CONFIG_HEAP_TRACING_STACK_DEPTH=2
CONFIG_HEAP_TASK_TRACKING=y
```
