## CMakeLists.txt
```
cmake_minimum_required(VERSION 3.13.1)

include($ENV{ZEPHYR_BASE}/cmake/app/boilerplate.cmake NO_POLICY_SCOPE)
project(z_in3)

target_sources(app PRIVATE src/main.c)

ADD_DEFINITIONS(-DTEST)
ADD_DEFINITIONS(-DDEBUG)
ADD_DEFINITIONS(-DUSE_SCRYPT=false)
SET(CMAKE_BUILD_TYPE Debug)
SET(CMAKE_VERBOSE_MAKEFILE ON)
ADD_DEFINITIONS(-DZEPHYR_OS)
ADD_DEFINITIONS(-DZEPHYR)
ADD_DEFINITIONS(-DIN3_MATH_LITE)

set(IN3_SRC ../..)
set(IN3_DEPS 
${IN3_SRC}/src/core 
${IN3_SRC}/src/verifier/eth1/basic 
${IN3_SRC}/src/verifier/eth1/nano 
${IN3_SRC}/src/signer/pk-signer 
${IN3_SRC}/src/api/eth1
${IN3_SRC}/src/api/utils
${IN3_SRC}/src/third-party/crypto
${IN3_SRC}/src/third-party/tommath
)

foreach(dep ${IN3_DEPS})
  file(GLOB files "${dep}/**/*.c")
  file(GLOB files2 "${dep}/*.c")
  #temp fix for building with a GLOB and not include all 3rd party libs
  list(FILTER files EXCLUDE REGEX ".*aestst.c$")
  target_sources(app PRIVATE "${files}" "${files2}")
  include_directories ("${dep}")
endforeach()
target_include_directories (app PRIVATE "../include")
```

## prj.conf
```kconfig
# nothing here
CONFIG_HEAP_MEM_POOL_SIZE=59436
CONFIG_PRINTK=y
CONFIG_MAIN_STACK_SIZE=2084
#CONFIG_ASSERT=y
#CONFIG_DEBUG_OPTIMIZATIONS=y
#SYSTEM_CLOCK_DISABLE=y
```

## src/main.c
```c
/*******************************************************************************
 * This file is part of the Incubed project.
 * Sources: https://github.com/slockit/in3-c
 * 
 * Copyright (C) 2018-2020 slock.it GmbH, Blockchains LLC
 * 
 * 
 * COMMERCIAL LICENSE USAGE
 * 
 * Licensees holding a valid commercial license may use this file in accordance 
 * with the commercial license agreement provided with the Software or, alternatively, 
 * in accordance with the terms contained in a written agreement between you and 
 * slock.it GmbH/Blockchains LLC. For licensing terms and conditions or further 
 * information please contact slock.it at in3@slock.it.
 * 	
 * Alternatively, this file may be used under the AGPL license as follows:
 *    
 * AGPL LICENSE USAGE
 * 
 * This program is free software: you can redistribute it and/or modify it under the
 * terms of the GNU Affero General Public License as published by the Free Software 
 * Foundation, either version 3 of the License, or (at your option) any later version.
 *  
 * This program is distributed in the hope that it will be useful, but WITHOUT ANY 
 * WARRANTY; without even the implied warranty of MERCHANTABILITY or FITNESS FOR A 
 * PARTICULAR PURPOSE. See the GNU Affero General Public License for more details.
 * [Permissions of this strong copyleft license are conditioned on making available 
 * complete source code of licensed works and modifications, which include larger 
 * works using a licensed work, under the same license. Copyright and license notices 
 * must be preserved. Contributors provide an express grant of patent rights.]
 * You should have received a copy of the GNU Affero General Public License along 
 * with this program. If not, see <https://www.gnu.org/licenses/>.
 *******************************************************************************/

#include "block_number.h"
#include "eth_api.h"   //wrapper for easier use
#include "eth_basic.h" // the full ethereum verifier containing the EVM
#include "receipt.h"
#include "util/log.h"
#include "util/mem.h"
/**
 * In3 Setup and usage
 * **/
/* Perform in3 requests for http transport */
in3_ret_t local_transport_func(char** urls, int urls_len, char* payload, in3_response_t* result) {
  for (int i = 0; i < urls_len; i++) {
    if (strstr(payload, "eth_getTransactionReceipt") != NULL) {
      printk("Returning eth_getTransactionReceipt ...\n");
      sb_add_range(&(result[i].result), mock_tx_receipt, 0, mock_tx_receipt_len);
    } else if (strstr(payload, "eth_blockNumber") != NULL) {
      printk("Returning eth_blockNumber ...\n");
      sb_add_range(&(result[i].result), block_number_res, 0, block_number_res_len);
    } else {
      in3_log_debug("Not supported for this mock\n");
    }
  }
  return IN3_OK;
}

in3_ret_t transport_mock(in3_request_t* req) {
  return local_transport_func((char**) req->urls, req->urls_len, req->payload, req->results);
}

in3_t* init_in3(in3_transport_send custom_transport, chain_id_t chain) {
  in3_t* in3 = NULL;
  //int    err;
  in3_log_set_quiet(0);
  in3_log_set_level(LOG_DEBUG);
  in3_register_eth_basic();
  in3 = in3_for_chain(chain);
  if (custom_transport)
    in3->transport = custom_transport; // use curl to handle the requests
  in3->request_count = 1;              // number of requests to sendp
  in3->max_attempts  = 1;
  in3->request_count = 1; // number of requests to sendp
  in3->chain_id      = chain;
  in3->flags         = FLAGS_STATS | FLAGS_INCLUDE_CODE | FLAGS_BINARY;
  for (int i = 0; i < in3->chains_length; i++) {
    _free(in3->chains[i].nodelist_upd8_params);
    in3->chains[i].nodelist_upd8_params = NULL;
  }
  return in3;
}

//this instruction makes the qemu exit, not in a clean way yet but it works
static inline void _exit_qemu() {
  register u32_t r0 __asm__("r0");
  r0 = 0x18;
  register u32_t r1 __asm__("r1");
  r1 = 0x20026;
  __asm__ volatile("bkpt #0xAB");
}

void main() {
  // the hash of transaction whose receipt we want to get
  in3_t*    in3 = init_in3(transport_mock, 0x5);
  bytes32_t tx_hash;
  hex_to_bytes("0x8e7fb87e95c69a780490fce3ea14b44c78366fc45baa6cb86a582166c10c6d9d", -1, tx_hash, 32);
  // get the tx receipt by hash
  eth_tx_receipt_t* txr = eth_getTransactionReceipt(in3, tx_hash);
  printk("status: %d ", txr->status);
  printk("gas: %lld ", txr->gas_used);
  printk("IN3 TEST PASSED !\n");
  eth_tx_receipt_free(txr);
  in3_free(in3);
  _exit_qemu();
}
```

## src/block_number.h
```c
// Imported from file 'block_number.bin'
const unsigned char block_number_res[] = {
	0xcd,0x41,0x64,0xb6,0xf9,0x23,0x32,0x2e,0x30,0x00,0xb6,0x89,0xbe,0x20,0x40,0x69,0x34,0x8d,0xa1,0x77,0x34,0x67,0x6b,0x72,0xa0,0x45,0x08,0xbe,0x1f,0xe8,0x09,0x1c,0xae,0xbc,0x69,0xe4,0xd4,0xbc,0x68,0x08,0x22,0xa1,0x87,0xa0,0xbe,0x20,0x40,0x69,0x3c,0xfa,0x25,0x32,0x2e,0x31,0x2e,0x30,0x00
};
const unsigned int block_number_res_len = 57;
```

## src/eth_call_response_binary.h
```c
// Imported from file 'eth_call.bin'
const unsigned char mock_eth_call_response[] = {
	0xdc,0x24,0x64,0xb6,0xf9,0x23,0x32,0x2e,0x30,0x00,0xb6,0x89,0x1c,0x20,0x00,0x00,0x00,0x00,0x00,0x00,0x00,0x00,0x00,
	0x00,0x00,0x00,0x00,0x00,0x00,0x00,0x00,0x00,0x00,0x00,0x00,0x00,0x00,0x00,0x00,0x00,0x00,0x00,0x00,0x00,0x00,0x01,
	0x34,0x8d,0xa1,0x77,0x34,0x68,0x4e,0xe4,0x64,0x42,0x18,0x29,0x63,0x61,0x6c,0x6c,0x50,0x72,0x6f,0x6f,0x66,0x00,0xc7,
	0xe9,0x1d,0x02,0x5c,0xf9,0x02,0x59,0xa0,0xd5,0xab,0xb4,0xae,0xd2,0x7b,0x77,0x9f,0xbe,0x49,0xd2,0x27,0x54,0x82,0x8d,
	0x0a,0x4e,0x6a,0xf9,0xce,0xa2,0x58,0x33,0xaf,0xd8,0xe6,0x50,0x49,0xe2,0xe9,0x15,0x79,0xa0,0x1d,0xcc,0x4d,0xe8,0xde,
	0xc7,0x5d,0x7a,0xab,0x85,0xb5,0x67,0xb6,0xcc,0xd4,0x1a,0xd3,0x12,0x45,0x1b,0x94,0x8a,0x74,0x13,0xf0,0xa1,0x42,0xfd,
	0x40,0xd4,0x93,0x47,0x94,0x00,0x00,0x00,0x00,0x00,0x00,0x00,0x00,0x00,0x00,0x00,0x00,0x00,0x00,0x00,0x00,0x00,0x00,
	0x00,0x00,0xa0,0x93,0xf7,0xc2,0x3f,0x0e,0x94,0x1e,0x76,0xb5,0xfa,0x63,0xa5,0xb2,0x7d,0xfb,0xc9,0x56,0xbd,0xd7,0x2a,
	0xa0,0xad,0x07,0xe2,0x20,0x40,0x51,0xef,0x45,0x00,0x33,0x19,0xa0,0x56,0xe8,0x1f,0x17,0x1b,0xcc,0x55,0xa6,0xff,0x83,
	0x45,0xe6,0x92,0xc0,0xf8,0x6e,0x5b,0x48,0xe0,0x1b,0x99,0x6c,0xad,0xc0,0x01,0x62,0x2f,0xb5,0xe3,0x63,0xb4,0x21,0xa0,
	0x56,0xe8,0x1f,0x17,0x1b,0xcc,0x55,0xa6,0xff,0x83,0x45,0xe6,0x92,0xc0,0xf8,0x6e,0x5b,0x48,0xe0,0x1b,0x99,0x6c,0xad,
	0xc0,0x01,0x62,0x2f,0xb5,0xe3,0x63,0xb4,0x21,0xb9,0x01,0x00,0x00,0x00,0x00,0x00,0x00,0x00,0x00,0x00,0x00,0x00,0x00,
	0x00,0x00,0x00,0x00,0x00,0x00,0x00,0x00,0x00,0x00,0x00,0x00,0x00,0x00,0x00,0x00,0x00,0x00,0x00,0x00,0x00,0x00,0x00,
	0x00,0x00,0x00,0x00,0x00,0x00,0x00,0x00,0x00,0x00,0x00,0x00,0x00,0x00,0x00,0x00,0x00,0x00,0x00,0x00,0x00,0x00,0x00,
	0x00,0x00,0x00,0x00,0x00,0x00,0x00,0x00,0x00,0x00,0x00,0x00,0x00,0x00,0x00,0x00,0x00,0x00,0x00,0x00,0x00,0x00,0x00,
	0x00,0x00,0x00,0x00,0x00,0x00,0x00,0x00,0x00,0x00,0x00,0x00,0x00,0x00,0x00,0x00,0x00,0x00,0x00,0x00,0x00,0x00,0x00,
	0x00,0x00,0x00,0x00,0x00,0x00,0x00,0x00,0x00,0x00,0x00,0x00,0x00,0x00,0x00,0x00,0x00,0x00,0x00,0x00,0x00,0x00,0x00,
	0x00,0x00,0x00,0x00,0x00,0x00,0x00,0x00,0x00,0x00,0x00,0x00,0x00,0x00,0x00,0x00,0x00,0x00,0x00,0x00,0x00,0x00,0x00,
	0x00,0x00,0x00,0x00,0x00,0x00,0x00,0x00,0x00,0x00,0x00,0x00,0x00,0x00,0x00,0x00,0x00,0x00,0x00,0x00,0x00,0x00,0x00,
	0x00,0x00,0x00,0x00,0x00,0x00,0x00,0x00,0x00,0x00,0x00,0x00,0x00,0x00,0x00,0x00,0x00,0x00,0x00,0x00,0x00,0x00,0x00,
	0x00,0x00,0x00,0x00,0x00,0x00,0x00,0x00,0x00,0x00,0x00,0x00,0x00,0x00,0x00,0x00,0x00,0x00,0x00,0x00,0x00,0x00,0x00,
	0x00,0x00,0x00,0x00,0x00,0x00,0x00,0x00,0x00,0x00,0x00,0x00,0x00,0x00,0x00,0x00,0x00,0x00,0x00,0x00,0x00,0x00,0x00,
	0x00,0x00,0x00,0x00,0x00,0x00,0x00,0x00,0x00,0x00,0x00,0x00,0x00,0x00,0x00,0x02,0x83,0x1f,0x1f,0x1c,0x83,0x7a,0x12,
	0x00,0x80,0x84,0x5e,0x27,0x24,0x3c,0xb8,0x61,0x4e,0x65,0x74,0x68,0x65,0x72,0x6d,0x69,0x6e,0x64,0x20,0x00,0x00,0x00,
	0x00,0x00,0x00,0x00,0x00,0x00,0x00,0x00,0x00,0x00,0x00,0x00,0x00,0x00,0x00,0x00,0x00,0x00,0xc5,0x1f,0xd9,0x66,0x9d,
	0x3b,0xad,0x78,0x4e,0x28,0xa3,0x1f,0xe5,0x60,0xf4,0x43,0xbf,0x4e,0x35,0x35,0xa4,0x84,0x4d,0xa4,0x3d,0xcc,0xaa,0x5b,
	0xeb,0x1e,0xd9,0xd9,0x2e,0x6c,0xf4,0xbb,0x0f,0xcc,0x15,0xae,0x0c,0x33,0x95,0xf6,0x5c,0x16,0x55,0xec,0x98,0x63,0x1e,
	0x14,0xc4,0x64,0x45,0x4d,0x1b,0x99,0x50,0x3f,0x9d,0x03,0xa2,0x0c,0x00,0xa0,0x00,0x00,0x00,0x00,0x00,0x00,0x00,0x00,
	0x00,0x00,0x00,0x00,0x00,0x00,0x00,0x00,0x00,0x00,0x00,0x00,0x00,0x00,0x00,0x00,0x00,0x00,0x00,0x00,0x00,0x00,0x00,
	0x00,0x88,0x00,0x00,0x00,0x00,0x00,0x00,0x00,0x00,0xb2,0x97,0x40,0x41,0x92,0x61,0xdf,0x43,0x67,0x0f,0x25,0x46,0x1d,
	0x02,0x14,0xf9,0x02,0x11,0xa0,0x7a,0x5f,0x1f,0x32,0xb8,0xc5,0xfd,0x40,0x0a,0xe9,0xc0,0x5f,0x4c,0x9c,0xad,0x07,0x8d,
	0x24,0x41,0xbb,0x28,0x05,0x21,0x3f,0x68,0xe3,0xee,0xde,0xe2,0xab,0x54,0x28,0xa0,0xb9,0xfe,0x2f,0xa9,0x42,0xd6,0x2c,
	0x90,0x3c,0xc4,0x00,0xaf,0x87,0x16,0x38,0xbf,0x72,0xc8,0xd8,0xc7,0xed,0xb9,0xd7,0xcf,0x05,0xa6,0x35,0x73,0x97,0x57,
	0x1d,0x6f,0xa0,0x47,0x2a,0x3b,0x5d,0x3d,0x5f,0xa2,0xef,0xda,0x7d,0x18,0x81,0xe9,0xfc,0x20,0x55,0x11,0x4d,0x0e,0xa4,
	0x4f,0xc9,0xb8,0xf3,0x21,0x63,0x4e,0x95,0x50,0xe8,0x48,0x1d,0xa0,0x64,0x23,0x16,0x9b,0xc8,0x00,0xc1,0x9a,0xfe,0x68,
	0xb3,0xcf,0x1d,0x35,0xc4,0xfe,0xa2,0x76,0x73,0xb9,0xbf,0x9b,0x86,0xb5,0x43,0x38,0x9e,0x1e,0x17,0xfa,0xef,0x17,0xa0,
	0xba,0xe5,0x22,0x48,0x83,0xa0,0xee,0xb6,0x4c,0xf9,0x38,0x83,0x66,0xf3,0x99,0x9e,0x05,0x63,0x19,0x61,0x5e,0x39,0x10,
	0x31,0xae,0xf3,0x21,0x6d,0x04,0x84,0xd3,0x69,0xa0,0xb9,0xc4,0xbc,0x79,0x95,0x89,0xe4,0x9d,0x31,0x53,0x1a,0xfc,0xca,
	0xe0,0x7d,0x03,0x45,0x25,0xec,0x6a,0xdf,0x11,0x91,0x7b,0x2a,0x1d,0x5b,0xe1,0x7c,0xb8,0x16,0x42,0xa0,0x04,0x83,0x01,
	0x79,0x15,0x81,0x77,0xc0,0x17,0x1b,0x5f,0xc4,0x97,0x5f,0xba,0xac,0xb7,0x01,0x7d,0x04,0xf7,0x11,0xa9,0x1f,0xe9,0xbd,
	0xe2,0x7c,0xce,0xbc,0x84,0xe7,0xa0,0xfd,0x80,0x00,0x7f,0xbc,0x36,0xc9,0x66,0x8a,0x24,0x27,0x40,0xf8,0x71,0x03,0xf3,
	0x03,0xa2,0xa5,0xd5,0xd4,0x1f,0xf9,0x6a,0x11,0x96,0xf4,0x81,0x8d,0x19,0xb6,0x01,0xa0,0x8e,0x2c,0x47,0x6e,0x4f,0x0a,
	0x33,0x8a,0x48,0x63,0xe8,0x82,0xa6,0xf0,0x0b,0xa1,0x7b,0xe3,0x77,0x4c,0x82,0xde,0x8d,0xb8,0x5b,0x2e,0xcb,0x65,0x51,
	0x50,0x4a,0xb9,0xa0,0x3f,0x8e,0x19,0xcd,0x9c,0xca,0xf0,0xc7,0xb0,0x53,0x26,0xb5,0xaa,0xb0,0x09,0x28,0x44,0xb8,0x74,
	0x9a,0xf9,0x17,0x41,0xfc,0x0b,0x80,0x70,0x69,0xd1,0x24,0x03,0x56,0xa0,0x23,0x0b,0x27,0x28,0xd9,0x40,0xb6,0x28,0xf1,
	0xa8,0xd1,0x4c,0x26,0xb4,0x9f,0x07,0x74,0xb4,0x92,0xa9,0x01,0x81,0x44,0x56,0x0e,0x35,0x15,0xa0,0x11,0x47,0x36,0x95,
	0xa0,0x3b,0x23,0xa7,0x2d,0x7a,0xdb,0xff,0x9a,0x30,0xfa,0x65,0xbe,0x41,0x97,0x63,0x1a,0x80,0xe2,0x40,0x30,0xf9,0x73,
	0xb5,0xe6,0x03,0x89,0x09,0x7f,0x79,0xbb,0xc4,0x02,0xa0,0xf1,0x3d,0x82,0xff,0xb3,0x7d,0x27,0x23,0xc6,0xdc,0x22,0xe8,
	0x67,0x7f,0x98,0x67,0x85,0xe3,0x84,0x5a,0x34,0xd9,0x11,0x0e,0xbe,0x4e,0x94,0x48,0x07,0xdd,0x29,0xce,0xa0,0x42,0x90,
	0x1a,0x4d,0xa7,0x5d,0x52,0x37,0x8a,0xdc,0xb1,0x5e,0x69,0x40,0x3e,0xe6,0xf8,0x59,0x03,0x53,0xb4,0xbf,0xed,0xdd,0xe4,
	0x88,0x0f,0x31,0xfd,0xce,0xd8,0x92,0xa0,0xbd,0x58,0x7f,0x5d,0x7c,0xaf,0x35,0x5e,0xd6,0x1f,0x0f,0x77,0xe5,0x68,0x91,
	0x06,0x4e,0x1f,0x89,0xc7,0xdc,0xf3,0x70,0xcf,0xe9,0x6b,0xe3,0x27,0x8e,0xc3,0x4f,0x4a,0xa0,0x8e,0x3b,0x1e,0x2d,0x6a,
	0x85,0x02,0x0e,0x9c,0x3b,0x10,0x1a,0x08,0x0f,0x35,0x69,0xbb,0x3f,0x66,0xb4,0x08,0x1e,0x35,0x4f,0x00,0x4f,0xa8,0x0a,
	0x35,0xe6,0x0c,0xf8,0x80,0x1d,0x02,0x14,0xf9,0x02,0x11,0xa0,0xf3,0x22,0xdf,0x9d,0x41,0x18,0x9d,0x1c,0x3d,0xe8,0x9c,
	0xe4,0xcc,0xca,0x4b,0x46,0xf2,0xa6,0x7d,0x56,0x40,0x35,0xd7,0x60,0x36,0x01,0x9d,0x32,0x8a,0x42,0x3e,0x2f,0xa0,0x6e,
	0x0e,0xd9,0x26,0x8c,0x8a,0x68,0x4f,0x09,0x04,0x1b,0x7c,0xa4,0x75,0xc8,0x87,0x04,0x2d,0xab,0x7b,0x05,0x32,0xf5,0xe9,
	0xde,0x1f,0x9f,0xc7,0x12,0xb8,0x70,0x98,0xa0,0x17,0x4c,0x76,0x1e,0xe1,0x66,0x22,0x90,0x1d,0xf2,0x08,0x3c,0x4c,0x21,
	0xa0,0xc9,0x53,0x0b,0x69,0x24,0xa4,0xb8,0xc9,0xe2,0x29,0xf4,0xef,0x65,0x0e,0x07,0xb1,0x68,0xa0,0x29,0xda,0xec,0x36,
	0xa3,0xb3,0x6d,0x75,0xfc,0xf1,0xb0,0x8e,0xb0,0xb6,0xf9,0x16,0x93,0x49,0xd4,0x9b,0x05,0x25,0xf3,0x66,0xa1,0xda,0xa2,
	0x77,0xce,0x6f,0x0f,0x5f,0xa0,0x63,0xb5,0xcf,0x37,0x72,0xf4,0x7a,0x2f,0x28,0xa1,0xf8,0x74,0xf2,0x3d,0x9f,0x35,0x3d,
	0x2c,0xf7,0xe6,0x70,0xa5,0x2a,0xe1,0xe2,0xd6,0x2c,0xf2,0x5b,0x96,0x25,0x44,0xa0,0xcd,0x2b,0xf9,0xfa,0x4a,0x0c,0x70,
	0xda,0xfc,0x22,0x4e,0xa2,0xdc,0x11,0xb2,0x8a,0x83,0x80,0x1a,0x14,0x0f,0x96,0xc9,0xed,0x10,0x8d,0x6d,0x83,0x1a,0x14,
	0xb3,0xf4,0xa0,0xe8,0xb7,0xfa,0xdf,0x49,0x23,0x31,0xcd,0x48,0xe4,0xf5,0x98,0xb4,0xd3,0x41,0x5f,0x49,0xa5,0x82,0x69,
	0xa2,0x9f,0x54,0xf2,0x63,0x45,0x85,0xf7,0xc0,0x0d,0xfc,0xec,0xa0,0x11,0xaf,0xf1,0x32,0x13,0x7d,0x5e,0x16,0xdb,0x6d,
	0xee,0x56,0x8b,0xb8,0x48,0x4e,0x2e,0x8d,0x7a,0x99,0xc9,0x85,0xef,0xd9,0xa8,0xdb,0x45,0xcf,0xe8,0x44,0x72,0x01,0xa0,
	0x1d,0x7a,0x47,0x42,0xb9,0x5b,0x4a,0xff,0x8f,0xd1,0x9f,0x34,0xea,0x85,0x21,0x2c,0x87,0x46,0xa5,0x1d,0x27,0xb1,0x9d,
	0xb5,0xee,0x18,0x06,0x4a,0x4a,0xe0,0xe7,0x5c,0xa0,0xe8,0xe8,0x1d,0x3c,0x5d,0x40,0xd7,0xb5,0xf1,0x4c,0xd7,0x28,0x7d,
	0xc2,0x6b,0x55,0x26,0x69,0x45,0x11,0xc6,0x5a,0x54,0x09,0xde,0xed,0x18,0x09,0xe4,0x40,0x3b,0xf4,0xa0,0x59,0x04,0xf8,
	0x49,0x94,0x1f,0xbf,0x96,0xe3,0x57,0x5f,0xd6,0x68,0xc9,0xd3,0x84,0xd6,0x70,0x86,0xfa,0xd0,0x5b,0x67,0x5e,0xfb,0x7c,
	0xbc,0xea,0x92,0x39,0xfb,0x7e,0xa0,0x3c,0x9b,0xef,0x4b,0x03,0xea,0x6a,0xa1,0xe7,0xe5,0xe2,0x4a,0x19,0xbd,0x92,0xfd,
	0x0a,0xe5,0x36,0x85,0x99,0x92,0x2e,0x55,0xef,0x09,0x96,0x99,0x8a,0x51,0xb9,0x33,0xa0,0x9c,0x9d,0x86,0xe0,0x2a,0xe3,
	0x3f,0x73,0x31,0x54,0xcb,0x10,0x50,0x7e,0x8f,0x32,0xef,0xa9,0xf2,0xc3,0xd4,0xb3,0x17,0x84,0xdf,0xd6,0x27,0xff,0x33,
	0x0a,0x68,0xd6,0xa0,0x17,0x1a,0xfb,0xb1,0x3a,0x82,0x8d,0xab,0x8c,0xd4,0x2f,0x6d,0x82,0x57,0xbd,0x2c,0x52,0x04,0x0d,
	0x09,0xab,0x79,0xe9,0xcd,0x12,0xe2,0xb2,0x9a,0xab,0xf0,0x73,0x6d,0xa0,0x6e,0xf4,0x0f,0x70,0x42,0x35,0xc4,0x55,0xe0,
	0x6f,0x06,0x58,0xe9,0x94,0xed,0xba,0x6d,0x3f,0xa9,0x8d,0x39,0x97,0xc3,0x7d,0x66,0xcd,0x92,0xcd,0x58,0xe7,0xba,0x80,
	0xa0,0x96,0x36,0x1d,0x0c,0xfc,0xc4,0xcd,0xa8,0xd9,0x04,0x71,0xf3,0xc3,0xc4,0xad,0x32,0xa0,0x48,0x90,0x15,0x86,0x60,
	0xdd,0xcc,0x9f,0x8e,0xbc,0x5a,0xf3,0x97,0xc5,0x39,0x80,0x1d,0x02,0x14,0xf9,0x02,0x11,0xa0,0xe8,0x57,0xfc,0x28,0x93,
	0x8c,0xca,0xac,0xe8,0xc4,0x03,0x12,0x8b,0xf9,0x84,0x8f,0xef,0x72,0x2f,0x25,0xf8,0xd5,0x5c,0x9d,0xfc,0xdd,0xd9,0x80,
	0xb0,0xb8,0x5c,0x7e,0xa0,0x32,0x9d,0x29,0xfc,0xe8,0xca,0x4e,0x48,0x07,0x20,0x57,0x51,0xe9,0xf4,0x37,0x69,0x26,0xe3,
	0xd5,0x6d,0xc3,0xbb,0x63,0x93,0x45,0xe4,0x10,0xdc,0x20,0xbc,0x2c,0x7b,0xa0,0x07,0x5e,0xdf,0xc7,0x24,0x6e,0x47,0x19,
	0xa2,0xc0,0x9c,0x39,0x7c,0x4c,0xea,0x41,0xd4,0x48,0x25,0x48,0x20,0xf1,0x97,0x4a,0x70,0x84,0x1b,0x9d,0x58,0xe3,0xbc,
	0xdd,0xa0,0x8f,0x48,0xb3,0x5a,0x91,0x7b,0x09,0x5e,0xd7,0x39,0x71,0xfa,0xf0,0x13,0x87,0x9b,0x77,0xa2,0x83,0x8d,0xe7,
	0x36,0x65,0x1b,0x48,0xa6,0xaa,0xa1,0x0a,0xb1,0x5e,0x8f,0xa0,0xc5,0x98,0x3f,0xe9,0x44,0x1f,0x72,0xcc,0x6c,0xb8,0xb5,
	0x79,0xf7,0x07,0x12,0x24,0x28,0x06,0x61,0xa4,0x5a,0x14,0x40,0x84,0x01,0xbb,0x1f,0x75,0x9d,0xbf,0x01,0x28,0xa0,0x3b,
	0x8c,0xbc,0x5e,0xd5,0x67,0x81,0x19,0x9f,0xb4,0xfb,0x97,0x68,0xc2,0xdd,0xcc,0x2b,0xdf,0x00,0x81,0x60,0x97,0xec,0x10,
	0x29,0x1b,0x30,0xac,0x89,0x64,0xbd,0x76,0xa0,0xd3,0xa8,0xe1,0x94,0x61,0x71,0x0a,0xee,0x36,0xc3,0x20,0x68,0x72,0x22,
	0x61,0x86,0x3b,0x86,0xc7,0xea,0xcb,0x50,0x18,0x8e,0x8f,0x30,0xde,0xaf,0xfa,0xe0,0x24,0xd2,0xa0,0xf1,0xb3,0x77,0xbc,
	0xc8,0xde,0x17,0x63,0x6d,0x7f,0x51,0xdb,0xb5,0x37,0x7f,0xdc,0x8b,0x9b,0x98,0xda,0x3e,0xa3,0x2e,0xdb,0xaf,0xd1,0x0f,
	0xf5,0x57,0xe6,0x5f,0x67,0xa0,0x17,0x56,0xae,0xbd,0x26,0xa3,0x7a,0x6d,0xfa,0x2e,0xba,0xb5,0x42,0x06,0xec,0x14,0xa4,
	0xed,0x1c,0x07,0x71,0x31,0x6a,0x93,0xb2,0x30,0x2d,0x02,0x9d,0xc9,0xfb,0x77,0xa0,0x16,0xcc,0x5d,0xb2,0x86,0xc0,0xa3,
	0x69,0x4d,0xd0,0xa5,0xdf,0xbf,0x17,0xae,0x7e,0x6e,0x71,0xee,0x86,0x34,0x5f,0x5b,0x44,0x7c,0x47,0x70,0x3d,0x21,0x6e,
	0x8a,0x49,0xa0,0x98,0x5d,0xe3,0xd8,0x14,0xa4,0xa4,0x20,0xfb,0x4a,0xa2,0x9c,0xea,0x55,0x04,0x47,0xff,0x26,0x70,0x0e,
	0x6f,0x82,0x01,0x97,0x98,0x53,0xe2,0xab,0x58,0xff,0xb8,0x81,0xa0,0x5c,0x37,0x52,0x0f,0x1f,0x9b,0x35,0x1e,0xfb,0x77,
	0x54,0x6b,0x89,0xba,0x56,0x2c,0xab,0x7e,0x3f,0xf8,0x46,0xf6,0x60,0xd2,0x92,0x4a,0x32,0x71,0x49,0xfd,0xa5,0x4a,0xa0,
	0x07,0xb0,0xf7,0x83,0xee,0xec,0xba,0x8d,0x2e,0x1b,0x19,0xcd,0x27,0xbc,0x32,0x96,0x2d,0x21,0xc7,0x85,0x89,0xfb,0x24,
	0x69,0x91,0x8c,0x27,0xfa,0x1f,0xb9,0xf3,0xf5,0xa0,0x7a,0xad,0xde,0x6f,0x5a,0x16,0xf1,0xbc,0x14,0xde,0xae,0x2c,0xfd,
	0xc5,0x9a,0x3b,0x12,0xfa,0x43,0x34,0xc8,0xab,0x3c,0xa9,0x38,0xa0,0xad,0x1f,0x16,0x51,0x71,0xd7,0xa0,0x85,0x53,0x71,
	0x2a,0x5b,0x41,0x9a,0xd8,0x74,0x2e,0x02,0xc1,0xb2,0x82,0x6f,0x9d,0x6f,0x22,0x6e,0xc2,0x92,0x05,0xf3,0x17,0x46,0x0e,
	0x35,0x43,0xc4,0x43,0x2c,0xfa,0xa0,0x98,0x9c,0xbf,0x17,0x57,0x8d,0xc3,0x1a,0x70,0x48,0xbb,0x6f,0x79,0x51,0xbb,0xcb,
	0x43,0x90,0xa4,0xdc,0x34,0x54,0x87,0x49,0xdd,0xec,0x58,0x08,0xff,0x70,0x17,0x90,0x80,0x1d,0x01,0xd4,0xf9,0x01,0xd1,
	0xa0,0xe5,0x87,0x84,0x36,0x7f,0xe3,0x98,0x67,0x9d,0x1e,0x6b,0xf7,0x8a,0x3d,0xde,0x3f,0xa1,0x0c,0x25,0x8a,0x65,0xee,
	0xa4,0x17,0x84,0x8e,0xaa,0x9c,0x13,0x65,0xc5,0x28,0x80,0xa0,0x2c,0x56,0x37,0x64,0xc4,0x50,0x27,0x4d,0xb1,0xcb,0x7e,
	0xd8,0x8c,0xb6,0x82,0xe3,0x57,0x59,0x32,0x63,0xc8,0x7f,0x03,0x70,0x2e,0x61,0xf2,0x70,0x38,0xe6,0xe9,0x22,0xa0,0x79,
	0x22,0xb0,0xa6,0x21,0xb8,0x76,0x90,0xb1,0xd9,0xc3,0xac,0x5d,0x65,0x45,0x3e,0x89,0x86,0xf7,0x11,0x93,0x10,0xaa,0xa2,
	0x38,0x2c,0xe9,0x77,0x90,0xc9,0x70,0xf6,0xa0,0x3b,0x79,0x1f,0x9b,0x5e,0xa7,0xb5,0x3c,0xcc,0x84,0xba,0xb0,0x5c,0x1a,
	0xb7,0xfc,0x18,0x2e,0x5b,0xd5,0x09,0x48,0x94,0x43,0xe2,0x43,0xa5,0x28,0x34,0xf1,0x2c,0x4d,0xa0,0x2f,0x36,0x49,0xd1,
	0xba,0xce,0xfd,0x45,0xf4,0xb8,0x6a,0x92,0x51,0x9e,0x11,0xfe,0xfd,0xe5,0x2b,0xf9,0xc0,0x33,0xde,0x30,0x5a,0xb0,0x1e,
	0x52,0xda,0x1e,0x48,0xe1,0xa0,0xa5,0xb9,0xe0,0xf7,0x51,0x6d,0xa5,0xfc,0x73,0x63,0xda,0x01,0x73,0x75,0x8c,0xf0,0x9a,
	0x9d,0x5e,0x69,0x08,0x71,0xde,0x79,0xcb,0x67,0x9c,0x4f,0xc5,0x84,0x61,0xa3,0xa0,0x1b,0x36,0x4c,0x94,0x43,0x63,0x70,
	0x5f,0x8e,0xce,0x38,0x0c,0xff,0x7c,0x2e,0x97,0xf0,0x2e,0xc6,0x0b,0xf1,0xdf,0xab,0x7f,0xb0,0x54,0x16,0x65,0x0e,0x52,
	0x1e,0x07,0xa0,0xd4,0xfc,0x2d,0xbc,0x2c,0x9c,0xda,0x95,0x84,0x4b,0xd3,0x54,0xe7,0xb1,0x5d,0x59,0x71,0x29,0x98,0x6c,
	0x08,0xd6,0x47,0x93,0x65,0x66,0xcd,0xc6,0xe6,0x70,0x67,0x03,0xa0,0xc0,0xe7,0x49,0xab,0x6f,0x93,0xf5,0xe2,0xd8,0xc3,
	0xdd,0xce,0x40,0x69,0xb1,0x42,0x09,0xbc,0x1a,0xf5,0x7a,0xe9,0x24,0x95,0xa2,0xaa,0xb3,0x29,0xc0,0x5c,0xec,0x46,0x80,
	0xa0,0x2c,0xe6,0x84,0x2b,0xaa,0x2c,0xf1,0xf1,0xae,0x3c,0xa8,0x3d,0x14,0x67,0x1d,0x05,0x42,0xa6,0x8d,0x56,0xee,0x6e,
	0x59,0x88,0xfc,0xf3,0xbe,0xbe,0x35,0x08,0x71,0xfb,0xa0,0x8b,0x65,0x3c,0x5e,0xec,0x87,0x17,0x51,0x95,0xfb,0xc9,0xf2,
	0xd4,0xea,0x48,0x12,0xf2,0x47,0xe8,0x75,0x0c,0x82,0xa8,0x98,0xda,0x21,0x37,0x54,0xdd,0x43,0x27,0x40,0xa0,0x67,0xfd,
	0x77,0x44,0x07,0x56,0x1e,0x7a,0x0a,0x58,0xda,0xb5,0x1f,0x06,0x0e,0x6a,0xae,0x9f,0x32,0x8b,0x5b,0x0d,0xa6,0x1e,0xab,
	0xb9,0xc3,0xfb,0xdc,0x7d,0x08,0x85,0xa0,0xfd,0x68,0x47,0x11,0x82,0x6b,0x61,0xca,0x2d,0xb1,0xc7,0x59,0xaa,0x1f,0xa7,
	0x35,0x80,0x76,0x07,0x7d,0x6b,0x39,0xee,0xbb,0x63,0x43,0x72,0xac,0xaf,0x24,0xd5,0x13,0xa0,0xf6,0xa4,0x20,0x56,0x04,
	0x67,0xe2,0xf0,0x37,0x3f,0x04,0x8d,0x29,0x56,0x36,0x53,0x02,0x1b,0x07,0xd9,0xe6,0xbe,0xc6,0x9b,0x0b,0x44,0x1a,0x2a,
	0xba,0x5c,0x18,0x46,0x80,0x1c,0x73,0xf8,0x71,0x80,0x80,0xa0,0x59,0x62,0xe5,0xc1,0x6b,0x55,0x95,0x5a,0x1b,0x3e,0x61,
	0x77,0x2a,0x6e,0x72,0x4d,0x3a,0x17,0x81,0xd0,0x15,0x60,0xa4,0x51,0xaf,0x48,0x63,0xfd,0x8e,0x9f,0xa9,0x3a,0x80,0x80,
	0x80,0xa0,0x1f,0x98,0xd4,0x5e,0x39,0x35,0xf9,0x5a,0xb0,0x0d,0x87,0x19,0xa0,0xfc,0x66,0x22,0xc7,0xb9,0x4f,0x22,0x2a,
	0xc5,0xa8,0x64,0x6c,0xdd,0xda,0x41,0xc9,0xd2,0xa0,0x5f,0x80,0x80,0x80,0x80,0xa0,0xfa,0x04,0xc9,0xc9,0x55,0xcb,0x58,
	0x79,0x6e,0x3c,0x31,0x16,0x3d,0xfc,0x2a,0x7e,0xab,0xe8,0x44,0xaf,0xa8,0x9b,0x2f,0xa5,0x6e,0x41,0xe3,0x74,0x49,0x8b,
	0x3d,0x78,0x80,0x80,0x80,0x80,0x80,0x1c,0x69,0xf8,0x67,0x9e,0x3f,0x79,0xd0,0x3b,0xcc,0xd3,0xd5,0x51,0x5f,0x1e,0x14,
	0xb1,0xab,0xc5,0xee,0xfe,0x02,0x7e,0x5a,0x72,0x52,0xbc,0xfd,0x9f,0x42,0x88,0x23,0xd3,0x59,0x3d,0xb8,0x46,0xf8,0x44,
	0x01,0x80,0xa0,0x82,0x1e,0x25,0x56,0xa2,0x90,0xc8,0x64,0x05,0xf8,0x16,0x0a,0x2d,0x66,0x20,0x42,0xa4,0x31,0xba,0x45,
	0x6b,0x9d,0xb2,0x65,0xc7,0x9b,0xb8,0x37,0xc0,0x4b,0xe5,0xf0,0xa0,0x8b,0xfc,0x1c,0x7c,0x74,0x64,0x66,0x0a,0x68,0xba,
	0x24,0x1e,0xa7,0x8b,0x6a,0x1d,0x36,0xcd,0x85,0xb5,0xcb,0x4f,0xba,0x52,0x1d,0x42,0x70,0xbd,0x0c,0x7d,0x7b,0xb7,0xb2,
	0xf6,0x14,0x36,0x64,0x3f,0x8d,0x17,0xfe,0x74,0x5a,0x69,0xa2,0xfd,0x22,0x18,0x89,0x21,0xfa,0xde,0x60,0xa9,0x8b,0x71,
	0xe6,0xa0,0x5e,0x3f,0x1c,0x20,0x8b,0xfc,0x1c,0x7c,0x74,0x64,0x66,0x0a,0x68,0xba,0x24,0x1e,0xa7,0x8b,0x6a,0x1d,0x36,
	0xcd,0x85,0xb5,0xcb,0x4f,0xba,0x52,0x1d,0x42,0x70,0xbd,0x0c,0x7d,0x7b,0xb7,0x46,0x69,0xa1,0x6d,0x4b,0x1c,0x20,0x82,
	0x1e,0x25,0x56,0xa2,0x90,0xc8,0x64,0x05,0xf8,0x16,0x0a,0x2d,0x66,0x20,0x42,0xa4,0x31,0xba,0x45,0x6b,0x9d,0xb2,0x65,
	0xc7,0x9b,0xb8,0x37,0xc0,0x4b,0xe5,0xf0,0x02,0xbd,0x41,0x63,0xf2,0xf7,0xa0,0x4e,0xe4,0x41,0x1c,0x24,0xe3,0xa1,0x20,
	0x29,0x0d,0xec,0xd9,0x54,0x8b,0x62,0xa8,0xd6,0x03,0x45,0xa9,0x88,0x38,0x6f,0xc8,0x4b,0xa6,0xbc,0x95,0x48,0x40,0x08,
	0xf6,0x36,0x2f,0x93,0x16,0x0e,0xf3,0xe5,0x63,0x01,0x4a,0x6b,0xa1,0x3c,0xfa,0x25,0x32,0x2e,0x31,0x2e,0x30,0x00,0x87,
	0xa0,0xbe,0x1f,0x1f,0x1c,0x6b,0x72,0xa0,0x45,0x08,0xbe,0x1e,0x97,0x26,0x1c,0xae,0xbc,0x91,0xe4,0xd4,0xbc,0x90,0x08,
	0x22,0xa2
};
const unsigned int mock_eth_call_response_len = 3176;
```
