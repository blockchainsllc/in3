## CMakeLists.txt
```
cmake_minimum_required(VERSION 3.8.2)
set(QEMU_EXTRA_FLAGS -s)

include($ENV{ZEPHYR_BASE}/cmake/app/boilerplate.cmake NO_POLICY_SCOPE)
project(NONE)


OPTION(DEBUG "DEBUG" OFF)
IF(DEBUG)
  ADD_DEFINITIONS(-DDEBUG)
  SET(CMAKE_BUILD_TYPE Debug)
ENDIF(DEBUG)


target_sources(app PRIVATE
	src/main.c
	src/fsm.c
	src/rent.c
)

# include core in the headers
include_directories ("${PROJECT_SOURCE_DIR}/../core")
#include_directories ("${PROJECT_SOURCE_DIR}/../eth_full")
include_directories ("${PROJECT_SOURCE_DIR}/../eth_nano")
#include_directories ("${PROJECT_SOURCE_DIR}/../eth_basic")
include(../core/include.cmake)

# choose which module to include
#include(../eth_basic/include.cmake)
include(../eth_nano/include.cmake)
include(../core/compiler.cmake)
set_property(GLOBAL PROPERTY C_STANDARD 99)

# add dependency
# add_subdirectory( ../core "${PROJECT_BINARY_DIR}/core")
#target_link_libraries(app core)
```

## prj.conf
```kconfig
CONFIG_PRINTK=y
CONFIG_HEAP_MEM_POOL_SIZE=131072

CONFIG_MAIN_STACK_SIZE=8192
CONFIG_SYSTEM_WORKQUEUE_STACK_SIZE=4096

CONFIG_RTT_CONSOLE=n

CONFIG_GPIO=y
CONFIG_BT=y
CONFIG_BT_DEBUG_LOG=n
CONFIG_BT_PERIPHERAL=y
CONFIG_BT_PRIVACY=n
CONFIG_BT_ATT_PREPARE_COUNT=2
CONFIG_BT_GATT_CLIENT=y
CONFIG_BT_L2CAP_DYNAMIC_CHANNEL=n
CONFIG_BT_TINYCRYPT_ECC=n
CONFIG_BT_DEVICE_NAME="in3-peripheral"
CONFIG_BT_DEVICE_NAME_DYNAMIC=y
CONFIG_BT_ID_MAX=4
CONFIG_BT_RX_BUF_COUNT=10
CONFIG_BT_RX_BUF_LEN=258
CONFIG_BT_L2CAP_TX_MTU=247
CONFIG_BT_L2CAP_TX_FRAG_COUNT=6
CONFIG_BT_L2CAP_TX_BUF_COUNT=10
CONFIG_BT_CONN_TX_MAX=10
CONFIG_BT_ATT_PREPARE_COUNT=10
CONFIG_BT_ID_MAX=4
CONFIG_BT_CTLR_RX_BUFFERS=10
CONFIG_BT_CTLR_TX_BUFFERS=10
CONFIG_BT_CTLR_TX_BUFFER_SIZE=251
CONFIG_BT_CTLR_DATA_LENGTH_MAX=251

CONFIG_BT_SETTINGS=y
CONFIG_FLASH=y
CONFIG_FLASH_PAGE_LAYOUT=y
CONFIG_FLASH_MAP=y
CONFIG_FCB=y
CONFIG_SETTINGS=y
CONFIG_SETTINGS_FCB=y
```

## src/main.c
```c
#include <stdio.h>
#include <string.h>
#include <zephyr.h>
#include <misc/util.h>
#include <kernel.h>
#include <misc/printk.h>
#include <string.h>
#include <gpio.h>
#include <device.h>

#include <settings/settings.h>

#include <bluetooth/hci.h>
#include <bluetooth/gatt.h>
#include <bluetooth/bluetooth.h>
#include <bluetooth/conn.h>
#include <bluetooth/l2cap.h>
#include <bluetooth/rfcomm.h>
#include <bluetooth/sdp.h>

#include "fsm.h"
#include "util/utils.h"
#include "util/bytes.h"

#include "util/debug.h"

// prototypes:
void bt_dev_show_info(void);
int start_message(int size);
void process_msg(void);

// defines:
#define CONFIG_GPIO_P0_DEV_NAME              "GPIO_0"
#define CONFIG_GPIO_P1_DEV_NAME              "GPIO_1"

// variables:
static struct bt_conn *default_conn = NULL;
static struct bt_gatt_ccc_cfg req_ccc_cfg[BT_GATT_CCC_MAX] = {};

static u32_t cnt;
struct device *ledpower; // green led (power)
struct device *ledstrip; // led strip (used as lamp)
struct device *lockpin; // lock out
struct device *gpio; // using blue led on usb board for testing

static u8_t recv_buf_static[512];
static u8_t req_buf[512];

static u8_t *recv_buf;
static u32_t b_off;
static u32_t total_len;

static u32_t start, end;
static struct in3_client *client;

/////////////////////////////
// callbacks for BT services:
//
static ssize_t read_req(struct bt_conn *conn, const struct bt_gatt_attr *attr, // callback from: BT_GATT_CHARACTERISTIC (req_char_uuid)
			void *buf, u16_t len, u16_t offset)
{
	const char *value = attr->user_data;
	u16_t value_len;

	dbg_log("<--- read req (len=%u ofs=%u)\n", len, offset);

	value_len = min(strlen(value), sizeof(req_buf)); // limit the length to req_buf size

	return bt_gatt_attr_read(conn, attr, buf, len, offset, value, value_len);
}

static ssize_t rx_data(struct bt_conn *conn, const struct bt_gatt_attr *attr,
			 const void *buf, u16_t len, u16_t offset,
			 u8_t flags)
{
	dbg_log("<--- len:%u\n", len);
	// if processing a message don't take new ones
	if (client->msg->ready)
		{
		dbg_log("<--- write req rejected (another message being processed)!!!\n");
		return BT_GATT_ERR(BT_ATT_ERR_WRITE_REQ_REJECTED);
		}
/*
	if (total_len == 0) {
		int mtu = bt_gatt_get_mtu(conn) - 3;
		dbg_log(" GATT MTU: %d, DATA_SIZE: %d len=%d\n", mtu+3, mtu, len);
	}
*/
	if (len == 0x8) {
		char magic[17];
		char *header = (char *) buf;
		if (total_len > 0) {
			dbg_log("<--- Channel already open, dismissing new request\n");
			return BT_GATT_ERR(BT_ATT_ERR_WRITE_REQ_REJECTED);
		}
		sprintf(magic, "%02x%02x%02x%02x%02x%02x%02x%02x", header[0], header[1],
			header[2], header[3], header[4], header[5], header[6], header[7]);
		if (header[0] == 0x69 &&
		    header[1] == 0x6e &&
		    header[2] == 0x33 &&
		    header[3] == 0x63) {
			dbg_log("<--- Magic: 0x%s\n", magic);
			if (start_message(*((int *) buf+1)))
				{
				dbg_log("<--- offset error\n");
				return BT_GATT_ERR(BT_ATT_ERR_INVALID_OFFSET);
				}
			bluetooth_clear_req();
			return len;
		}
	}

	if(recv_buf == 0) // if no space allocated
		recv_buf = k_calloc(1, total_len);
	////////////////////////////////////////////////////

	memcpy(recv_buf + b_off, buf, len);
	b_off += len;

	if (b_off >= total_len) {
		end = k_uptime_get_32();
		process_msg();
	}

	return len;
}

static void req_ccc_cfg_changed(const struct bt_gatt_attr *attr, u16_t value) // Callback from: BT_GATT_CCC (req_ccc_cfg, req_ccc_cfg_changed)
{
	dbg_log("<--- value = %u\n", value);
}

// define an UUID for msg_svc (BT_GATT_PRIMARY_SERVICE)
static struct bt_uuid_128 msg_svc_uuid = BT_UUID_INIT_128(
	0x01, 0xde, 0xbc, 0x9a, 0x78, 0x56, 0x34, 0x12,
	0x78, 0x56, 0x34, 0x12, 0x78, 0x56, 0x34, 0x12);

// define an UUID for msg_char (BT_GATT_CHARACTERISTIC #1)
static const struct bt_uuid_128 msg_char_uuid = BT_UUID_INIT_128(
	0x02, 0xde, 0xbc, 0x9a, 0x78, 0x56, 0x34, 0x12,
	0x78, 0x56, 0x34, 0x12, 0x78, 0x56, 0x34, 0x12);

// define an UUID for req_char (BT_GATT_CHARACTERISTIC #2)
static const struct bt_uuid_128 req_char_uuid = BT_UUID_INIT_128(
	0x02, 0xde, 0xbc, 0x9a, 0x78, 0x56, 0x34, 0x12,
	0x78, 0x56, 0x34, 0x12, 0x78, 0x56, 0x34, 0x13);

// define an UUID for notify (BT_GATT_CHARACTERISTIC #3)
static const struct bt_uuid_128 notify_uuid = BT_UUID_INIT_128(
	0x02, 0xde, 0xbc, 0x9a, 0x78, 0x56, 0x34, 0x12,
	0x78, 0x56, 0x34, 0x12, 0x78, 0x56, 0x34, 0x14);

static struct bt_gatt_attr msg_attrs[] = {
		BT_GATT_PRIMARY_SERVICE(&msg_svc_uuid), // [0] primary service

////////////////////////////////////////////////////////////////////////
		BT_GATT_CHARACTERISTIC(&msg_char_uuid.uuid, // [1] characteristic attribute uuid
			BT_GATT_CHRC_WRITE, // char att properties
			BT_GATT_PERM_WRITE | BT_GATT_PERM_PREPARE_WRITE, // char att permissions
			NULL, rx_data, recv_buf_static), // char att read callback, write callback, value

		BT_GATT_CHARACTERISTIC(&req_char_uuid.uuid, // [2] characteristic attribute uuid
			BT_GATT_CHRC_READ, // char att properties
			BT_GATT_PERM_READ, // char att permissions
			read_req, NULL, req_buf), // char att read callback, write callback, value

		BT_GATT_CHARACTERISTIC(&notify_uuid.uuid, // [3] characteristic attribute uuid
			BT_GATT_CHRC_NOTIFY, // char att properties
			BT_GATT_PERM_NONE, // char att permissions
			NULL, NULL, NULL), // char att read callback, write callback, value
////////////////////////////////////////////////////////////////////////

		BT_GATT_CCC(req_ccc_cfg, req_ccc_cfg_changed), // [4] initial config, callback to configuration change
};

////////
// Code:
//
int start_message(int size)
{
	int old_len = total_len;
	total_len = size;
	dbg_log("RX Message (length: %lu bytes)\n", total_len);

	if (recv_buf && (old_len > total_len)) {
		memset(recv_buf, 0, total_len);
		goto out;
	}

	if (recv_buf)
		k_free(recv_buf);

	recv_buf = k_calloc(1, total_len * sizeof(char));

out:
	if (!recv_buf) {
		dbg_log("Error allocating RX buf (size=%lu)\n", total_len);
		return -1;
	}

	start = k_uptime_get_32();

	k_mutex_lock(&client->mutex, 5000);

	return 0;
}

void process_msg(void)
{
	client->msg->data = recv_buf;
	client->msg->size = total_len;

	client->msg->ready = 1;

	b_off = 0;
	total_len = 0;

	k_mutex_unlock(&client->mutex);
	in3_signal_event();
}

void clear_message(struct in3_client *c)
{
	// EFmod: in case of raw message received, msg->ready flag will NOT be reset
	//  and this may hang the program; so, do this anyway:
	c->msg->ready = 0; // EFmod - may be also this is unassigned

	if (!recv_buf)
		return;

	k_free(recv_buf);

	c->msg->size = 0;
	c->msg->ready = 0;

	b_off = 0;
	total_len = 0;

	recv_buf = 0;
	c->msg->data = 0;
}

static struct bt_gatt_service msg_svc = BT_GATT_SERVICE(msg_attrs);

static const struct bt_data ad_discov[] = {
	BT_DATA_BYTES(BT_DATA_FLAGS, (BT_LE_AD_GENERAL | BT_LE_AD_NO_BREDR)),
};

static void connected(struct bt_conn *conn, u8_t err)
{
	dbg_log("<---\n"); // function is shown on the left
	default_conn = conn;
}

static void disconnected(struct bt_conn *conn, u8_t reason)
{
	dbg_log("<---\n"); // function is shown on the left
}

static bool le_param_req(struct bt_conn *conn, struct bt_le_conn_param *param)
{
int mtu = bt_gatt_get_mtu(conn);

	dbg_log("<--- req MTU=%d\n", mtu);
	return true;
}

static void le_param_updated(struct bt_conn *conn, u16_t interval, u16_t latency, u16_t timeout)
{
int mtu = bt_gatt_get_mtu(conn);

	dbg_log("<--- upd MTU=%d\n", mtu);
	return;
}

static struct bt_conn_cb conn_cbs = {
	.connected = connected,
	.disconnected = disconnected,
	.le_param_req = le_param_req,
	.le_param_updated = le_param_updated,
};

static void bt_ready(int err)
{
	default_conn = NULL;
	bt_conn_cb_register(&conn_cbs);
}

void bluetooth_write_req(char *msg)
{
	k_mutex_lock(&client->mutex, 5000);

	if (strlen(msg) > sizeof(recv_buf_static)) // EFmod: may be req_buf ?
		return;

	strcpy(req_buf, msg);
	dbg_log("<--- buffer prepared for req_char:\n%s\n", req_buf);

	k_mutex_unlock(&client->mutex);

	dbg_log("send notification for REQ\n");

	char *send = "REQ_READY";
//  EFmod: the "normal" [3] does not work. Index [5] is out of bounds, but it works...
	bt_gatt_notify(NULL, &msg_attrs[5], send, strlen(send));
}

void bluetooth_clear_req(void)
{
	memset(req_buf, 0, sizeof(recv_buf_static)); // EFmod: may be sizeof(req_buf) ?
}

// START block: next 3 functions needed only if hardcoded mac is requested
static int char2hex(const char *c, u8_t *x)
{
	if (*c >= '0' && *c <= '9') {
		*x = *c - '0';
	} else if (*c >= 'a' && *c <= 'f') {
		*x = *c - 'a' + 10;
	} else if (*c >= 'A' && *c <= 'F') {
		*x = *c - 'A' + 10;
	} else {
		return -EINVAL;
	}

	return 0;
}

static int str2bt_addr(const char *str, bt_addr_t *addr)
{
	int i, j;
	u8_t tmp;

	if (strlen(str) != 17) {
		return -EINVAL;
	}

	for (i = 5, j = 1; *str != '\0'; str++, j++) {
		if (!(j % 3) && (*str != ':')) {
			return -EINVAL;
		} else if (*str == ':') {
			i--;
			continue;
		}

		addr->val[i] = addr->val[i] << 4;

		if (char2hex(str, &tmp) < 0) {
			return -EINVAL;
		}

		addr->val[i] |= tmp;
	}

	return 0;
}

static int str2bt_addr_le(const char *str, const char *type, bt_addr_le_t *addr)
{
	int err;

	err = str2bt_addr(str, &addr->a);
	if (err < 0) {
		return err;
	}

	if (!strcmp(type, "public") || !strcmp(type, "(public)")) {
		addr->type = BT_ADDR_LE_PUBLIC;
	} else if (!strcmp(type, "random") || !strcmp(type, "(random)")) {
		addr->type = BT_ADDR_LE_RANDOM;
	} else {
		return -EINVAL;
	}

	return 0;
}
// END block

int bluetooth_setup(struct in3_client *c)
{
	int err;
	size_t ad_len, scan_rsp_len = 0;
	struct bt_le_adv_param param;
	const struct bt_data *ad = 0, *scan_rsp = 0;

// Enable to hardcode MAC address
#if 0
	// client (this)
	bt_addr_le_t addr;
//	char *c_addr = "d3:6c:29:4b:6b:45";
	char *c_addr = "c0:00:00:00:00:00"; // EFmod:
	char *c_addr_type = "(random)";
	err = str2bt_addr_le(c_addr, c_addr_type, &addr);
	bt_set_id_addr((const bt_addr_le_t *) &addr);
#endif

	err = bt_enable(bt_ready);
	if (err) {
		dbg_log("Unable to setup bluetooth");
		return -1;
	}

	k_sleep(1000);
	bt_dev_show_info();

	param.id = 0;
	param.interval_min = BT_GAP_ADV_FAST_INT_MIN_2;
	param.interval_max = BT_GAP_ADV_FAST_INT_MAX_2;
	param.options = (BT_LE_ADV_OPT_CONNECTABLE |
				 BT_LE_ADV_OPT_USE_NAME);
	ad = ad_discov;
	ad_len = ARRAY_SIZE(ad_discov);

	if (IS_ENABLED(CONFIG_SETTINGS)) {
		settings_load();
	}

//	bt_set_name("in3-peripheral");
	bt_set_name("in3-emiliotest"); // EFmod: just for testing with Ardo's App

	err = bt_le_adv_start(&param, ad, ad_len, scan_rsp, scan_rsp_len);
	if (err < 0) {
		dbg_log("Failed to start advertising (err %d)\n", err);
		return -1;
	} else {
		dbg_log("Advertising started\n");
	}

	// set client data
	client = c;
	client->msg->data = recv_buf;

	recv_buf = 0;
	b_off = 0;
	total_len = 0;

	dbg_log("Registering GATT service\n");
	err = bt_gatt_service_register(&msg_svc);

	if (err < 0) {
		dbg_log("Failed to register servic\n");
		return -1;
	} else {
		dbg_log("Service registered\n");
	}

	return 0;
}
///////// new GPIO functions
void ledpower_set(int state)
{
	if(state) // if ON
		gpio_pin_write(ledpower, LEDPOWER, 0); // led with negative logic
	else // if OFF
		gpio_pin_write(ledpower, LEDPOWER, 1); // led with negative logic
}

void ledstrip_set(int state)
{
	if(state) // if ON
		gpio_pin_write(ledstrip, LEDSTRIP, 1); // led with positive logic
	else // if OFF
		gpio_pin_write(ledstrip, LEDSTRIP, 0); // led with positive logic
}

void lock_set(int state)
{
	if(state) // if ON
		gpio_pin_write(lockpin, LOCKPIN, 1); // coil with positive logic
	else // if OFF
		gpio_pin_write(lockpin, LOCKPIN, 0); // coil with positive logic
}

int gpio_setup(void)
{
	ledpower = device_get_binding(LEDPOWER_PORT); // CONFIG_GPIO_P0_DEV_NAME
	gpio_pin_configure(ledpower, LEDPOWER, GPIO_DIR_OUT); // set as output (see fsm.h)
	ledpower_set(IO_ON);

	ledstrip = device_get_binding(LEDSTRIP_PORT);
	gpio_pin_configure(ledstrip, LEDSTRIP, GPIO_DIR_OUT); // set as output (see fsm.h)
	ledstrip_set(IO_OFF);

	lockpin = device_get_binding(LOCKPIN_PORT);
	gpio_pin_configure(lockpin, LOCKPIN, GPIO_DIR_OUT); // set as output (see fsm.h)
	lock_set(IO_OFF);

	for(int i = 0, cnt = 0; i < 5; i++, cnt++) // blink led and terminate ON
		{
		ledpower_set(cnt % 2);
		k_sleep(200);
		}
	ledpower_set(IO_ON);
	return 0;
}
/////////////////////// end of new GPIO functions

void main(void)
{
	in3_client_start();
	return;
}
```

## src/fsm.c
```c
#include <kernel.h>
#include <misc/printk.h>
#include <stdio.h>
#include <string.h>

#include "fsm.h"
#include "rent.h"
#include "util/utils.h"
#include <eth_nano.h>

// Global Client
struct in3_client*  client;
struct k_timer *timer, *timer1, *timer2, *timer3; // timer structures
int                 undo;

// private
static void timer_expired(struct k_timer* work) {
  undo = 1;
  k_sem_give(&client->sem);
}

static void timer1_expired(struct k_timer *work) // one shot timer (monitor led)
{
	ledpower_set(IO_ON); // power led on
}

static void timer2_expired(struct k_timer *work) // one shot timer (led stripe)
{
	ledstrip_set(IO_OFF); // ledstrip off
}

static void timer3_expired(struct k_timer *work) // one shot timer (lock-coil)
{
	lock_set(IO_OFF); // lock off
}

static void wait_for_event(void) {
  if (!client)
    return;

//  k_sem_take(&client->sem, 600000); // EFnote: 600000 mS = 600 sec = 10 min
  k_sem_take(&client->sem, K_SECONDS(60)); // 60 sec = 1 min
}

void do_action(action_type_t action)
{
	ledpower_set(IO_OFF); // power led off
	k_timer_start(timer1, 250, 0); // start timer 1 initial duration 250mS, period = 0
	if (action == LOCK)
		{
		printk("action: LOCK\n");
		}
	else
		{
		printk("action: UNLOCK\n");
		ledstrip_set(IO_ON); // led on
		k_timer_start(timer2, 15000, 0); // start timer 2 initial duration 15*1000mS, period = 0
		lock_set(IO_ON); // lock on
		k_timer_start(timer3, 1500, 0); // start timer 3 initial duration 1500mS, period = 0
		}
}

// PUBLIC API
void in3_signal_event(void) {
  if (!client)
    return;

  k_sem_give(&client->sem);
}

/////////////////////////////////////

/*******************/
/*  state machine  */
/*******************/

typedef enum {
  STATE_INIT,
  STATE_WAITING,
  STATE_ACTION,
  STATE_RESET,
  STATE_MAX
} in3_state_t;

typedef in3_state_t in3_state_func_t(void);

static in3_state_t in3_init(void) {
  client = k_calloc(1, sizeof(struct in3_client));
  timer = k_calloc(1, sizeof(struct k_timer));
	timer1 = k_calloc(1, sizeof(struct k_timer)); // allocate 1 array element of K_timer size
	timer2 = k_calloc(1, sizeof(struct k_timer)); // allocate 1 array element of K_timer size
	timer3 = k_calloc(1, sizeof(struct k_timer)); // allocate 1 array element of K_timer size

  client->in3               = in3_new();
  client->in3->chainId      = 0x044d;
  client->in3->requestCount = 1;
  client->in3->max_attempts=1;

  client->txr = k_calloc(1, sizeof(in3_tx_receipt_t));
  client->msg = k_calloc(1, sizeof(in3_msg_t));

  in3_register_eth_nano();
  bluetooth_setup(client);
	gpio_setup();
//  led_setup();
  k_sem_init(&client->sem, 0, 1);
  k_mutex_init(&client->mutex);
  k_timer_init(timer, timer_expired, NULL);
	k_timer_init(timer1, timer1_expired, NULL); // init timer, callback for expired, callback for stopped
	k_timer_init(timer2, timer2_expired, NULL); // init timer, callback for expired, callback for stopped
	k_timer_init(timer3, timer3_expired, NULL); // init timer, callback for expired, callback for stopped

  return STATE_WAITING;
}

static in3_state_t in3_waiting(void) {
  k_mutex_lock(&client->mutex, 10000);
  if (client->msg->ready) {
    client->msg->start = k_uptime_get_32();
//		if (msg_get_type(client) == T_ACTION) {
    if (msg_get_type(client->msg->data) == T_ACTION) {
      k_mutex_unlock(&client->mutex);
      return STATE_ACTION;
    }
    client->msg->end = k_uptime_get_32();
    clear_message(client);
  }

  k_mutex_unlock(&client->mutex);
  wait_for_event();

  if (undo) {
    do_action(LOCK);
    undo = 0;
  }

  return STATE_WAITING;
}

static in3_state_t in3_action(void) {
  int           err;
//	action_type_t action = msg_get_action(client);
  action_type_t action = msg_get_action(client->msg->data); // EFmod:

  if (action != LOCK && action != UNLOCK)
    return STATE_RESET;

  // reset rental
  if (client->rent) {
    k_free(client->rent->controller);
    k_free(client->rent);
  }

	client->rent = k_calloc(1, sizeof(in3_rental_t));
	client->rent->when = json_get_int_value(client->msg->data, "timestamp");

  err = verify_rent(client);
  if (err) {
    return STATE_RESET;
  }

  do_action(action);

  if (action == UNLOCK)
    k_timer_start(timer, K_SECONDS(5), 0);

  return STATE_RESET;
}

static in3_state_t in3_reset(void) {
  client->msg->end = k_uptime_get_32();

  clear_message(client);

  return STATE_WAITING;
}

in3_state_func_t* const state_table[STATE_MAX] = {
    in3_init,
    in3_waiting,
    in3_action,
    in3_reset,
    NULL
};

static in3_state_t run_state(in3_state_t state) {
  return state_table[state]();
}

int in3_client_start(void) {
  in3_state_t state = STATE_INIT;

  while (1) {
    state = run_state(state);
  }
}
```

## src/rent.c
```c
#include <stdio.h>
#include <string.h>
#include <rtc.h>
#include <client/client.h>
#include "fsm.h"
#include "util/debug.h"
#include "util/stringbuilder.h"
#include <crypto/secp256k1.h>
#include <crypto/ecdsa.h>
#include <util/data.h>
#include <eth_nano.h>

msg_type_t msg_get_type(char *c)
{
char buf[20]; // allocate tmp space for string compare

	msg_type_t type = T_ERROR;
	if(strstr(c, "msgType") == 0) // if received string does not contain msgType
		return type;

 	// NOTE: check buf size (will need an additional function like json_get_str_length
	//       or to modify json_get_str_value with additional parameter maxlen)

    json_get_str_value(c, "msgType", buf);
	if (strcmp(buf, "action") == 0) // if string match
		type = T_ACTION;
	else if (strcmp(buf, "in3Response") == 0) // if string match
		type = T_RESPONSE;

	return type;
}

action_type_t msg_get_action(char *c)
{
char buf[20]; // allocate tmp space for string compare

	action_type_t type = NONE;
	if(strstr(c, "action") == 0) // if received string does not contain action
		return type;
		
 	// NOTE: check buf size (will need an additional function like json_get_str_length
	//       or to modify json_get_str_value with additional parameter maxlen)

    json_get_str_value(c, "action", buf); // note: check buf size (need some json_get_str_length)
	if (strcmp(buf, "unlock") == 0) // if string match
		type = UNLOCK;
	else if (strcmp(buf, "lock") == 0) // if string match
		type = LOCK;

	return type;
}

char *msg_get_response(struct in3_client *c)
{
	char *val = 0;

	if (!c->msg->ready)
		return T_ERROR;

	val = json_get_json_value(c->msg->data, "responses");
	return val;
}

// get_tx_hash - called by verify_rent (rent.c)
static int get_tx_hash(char *msg, char* dst)
{
    *dst = 0; // preset out string as an empty string
	json_get_str_value(msg, "transactionHash", dst); // note: check dst buf len
	if (strncmp(dst, "0x", 2)) // EFnote: need to check also 0X ???
		return -1; // good
	return 0; // bad
}

// wait_for_message - called by send_ble
int wait_for_message(struct in3_client *c)
{
	int i = 100;

	dbg_log("<--- wait_for_message\n");
	while (c->msg->ready == 0 && i--)
		k_sleep(100);

	k_mutex_lock(&c->mutex, 30000);
	k_mutex_unlock(&c->mutex);

	if (c->msg->ready) {
		dbg_log("<--- msg received!\n");
		return 0;
	}
	dbg_log("<--- timeout error!\n");
	return i; // -1 if timeout elapsed
}

static struct in3_client *_client=NULL;

int send_ble(char** urls,int urls_len, char* pl, in3_response_t* result)  {
    char payload[5120]; // EFmod -so big ?

	sprintf(payload,"{\"msgType\":\"in3Request\",\"msgId\":1,\"url\":\"%s\",\"method\":\"POST\",\"data\":%s}",*urls,pl);

	clear_message(_client);
	bluetooth_write_req(payload);
	int err = wait_for_message(_client);
	bluetooth_clear_req();

	_client->txr->data = NULL;

	if (err < 0) {
        sb_add_chars(&result->error, "Error receiving this response");
		return err;
	}

	_client->txr->data = msg_get_response(_client);
    sb_add_chars(&result->result, _client->txr->data);
	return 0;
}

// in3_get_tx_receipt - called by verify_rent;
int in3_get_tx_receipt(struct in3_client *c, char *tx_hash, char **response)
{
	char params[512]; // EFmod: (IN3_REQ_FMT string is 240 chars long)
	char* result=NULL;
	char* error=NULL;

	if (!c || !tx_hash)
		return -1;

    _client=c;
	c->in3->transport = send_ble;
	// first check if cached receipt matches
	if (c->txr->hash && !strcmp(c->txr->hash, tx_hash)) {
		//clear_message(c);
		*response = c->txr->data;
		return 0;
	}

	k_free(c->txr->data);
	k_free(c->txr->hash);
	memset(c->txr, 0, sizeof(in3_tx_receipt_t));

	sprintf(params, "[\"%s\"]", tx_hash);

	c->in3->transport = send_ble; // Assign the transport function (executed when needed)

    in3_client_rpc(c->in3, "eth_getTransactionReceipt", params, &result, &error);

    if (error) {
     	dbg_log("<--- got s error: %s\n", error);
		*response =NULL;
		k_free(error);
	}
	else {
		c->txr->data = result; // 190131 solves the issue in caching
		*response = result;
		//TODO don't need it!
		c->txr->hash = k_calloc(1, strlen(tx_hash)+1);
		c->txr->hash = memcpy(c->txr->hash, tx_hash, strlen(tx_hash));
	}

	return 0;
}

int in3_can_rent(struct in3_client *c, char *resp, char *amsg) {
	int res=-1,i;
    char tmp[256], mhash[256];
	json_parsed_t*  response = parse_json(resp);
	json_parsed_t*  message  = parse_json(amsg);
	d_token_t* l, *log=NULL;
	bytes_t* signer=NULL,  *hash=NULL;
	bytes_t* log_rented = hex2byte_new_bytes("9123e6a7c5d144bd06140643c88de8e01adcbb24350190c02218a4435c7041f8",64);


	if (!response || !message) goto out; 

	d_token_t* logs = d_get(response->items,key("logs"));
	if (!logs)  goto out;

	for (i=0,l=logs+1;i<d_len(logs);i++,l=d_next(l)) {
		if (b_cmp(d_get_bytes_at(d_get(l,key("topics")),0),log_rented)) {
			log=l;
			break;
		}
	}

    // no event found,
	if (!log) goto out; 

	char* url         = d_get_string(message->items,"url");
    //bytes_t* deviceId = d_get_bytes_at(d_get(log,key("topics")),1);  // we need to store and compare the deviceId
	bytes_t* data     = d_get_bytes(log,"data");
	
	c->rent->from  = bytes_to_long(data->data+32,32);
	c->rent->until = bytes_to_long(data->data+64,32);
    //TODO do we need to set it as string?
    c->rent->controller = _malloc(43);
    c->rent->controller[0]='0';
    c->rent->controller[1]='x';
	int8_to_char(data->data+12,20,c->rent->controller+2);


	dbg_log("*** controller: '%s'\n", c->rent->controller);
	dbg_log("*** from: %d, until: %d, when: %d\n", c->rent->from, c->rent->until, c->rent->when);

    // wrong time
	if (c->rent->from >= c->rent->when ||  c->rent->when >= c->rent->until)  goto out;

	// check signature


    // prepare message hash
	sprintf(tmp, "%s%d%s{}", url, c->rent->when, d_get_string(message->items,"action"));
	sprintf(mhash, "\031Ethereum Signed Message:\n%d%s", strlen(tmp), tmp);
	bytes_t msg= { .data = (uint8_t*) &mhash, .len = strlen(mhash) };
    hash = sha3(&msg);

    // get the signature
	signer = ecrecover_signature(hash,  d_get(message->items,key("signature")));
	if (signer==NULL) goto out;

    // check if the signer is the same as the controller in the event.
    // reuse msg to point to the address in the event.
	msg.data = data->data+12;
	msg.len  = 20;
	if (!b_cmp(signer, &msg))  goto out;

	//TODO check if the url and the deviceid is correct.
	// if (strcmp(url, saved_url)!=0)          goto out;
	// if (!b_comp(device_id, saved_device_id)) goto out;
	// if (!b_comp( d_get_bytes(response,"contractAddress") , saved_contract)) goto out;

	res = 0;
	
	out:
	if (response) _free(response);
	if (message)  _free(message);
	if (hash)     b_free(hash);
	if (signer)   b_free(signer);
	b_free(log_rented);

	return res;
}

// verify_rent - called by in3_action (state machine, fsm.c)
int verify_rent(struct in3_client *c)
{
	int ret = -1, id = 0;
	char tx_hash[67], *r = 0;
	char *amsg = 0;
	char payload[512]; // EFnote: the payload in send_ble is 10 times bigger

	get_tx_hash(c->msg->data, tx_hash); // get tx_hash from msg->data
	if (tx_hash[0] == 0) // if empty string (errors in get_tx_hash)
		goto out; // note: ret = -1

	// keep copy of action message
	amsg = k_calloc(1, sizeof(char) * (c->msg->size + 1));
	amsg = memcpy(amsg, c->msg->data, c->msg->size + 1);
	id = json_get_int_value(amsg, "msgId");

	in3_get_tx_receipt(c, tx_hash, &r); // try to receive response 
	if (r)
		dbg_log("<--- response:\n%s\n", r);

	if (in3_can_rent(c, r, amsg) < 0)
		goto out;

	ret = 0;

out:
	if (ret)
		sprintf(payload, "{\"msgId\":%d,\"msgType\":\"error\",\"error\":\"Invalid rental\"}", id);
	else
		sprintf(payload, "{\"msgId\":%d,\"msgType\":\"action\",\"result\":\"success\"}", id);

	bluetooth_write_req(payload);

	if (amsg)
		k_free(amsg);

	return ret;
}
```
