## CMakeLists.txt
```
cmake_minimum_required(VERSION 3.8.2)
set(QEMU_EXTRA_FLAGS -s)

#######################################################
### OPTIONS ###    REMEMBER TO RUN cmake.sh WHEN    ###
#                   YOU MAKE CHANGES IN OPTIONS!    ###
#######################################################

OPTION(USB_DONGLE "Set this ON for USB dongle version" ON)
OPTION(BT_MAC "Set this to force hardcoded BT MAC address" OFF)
OPTION(DEBUG "Set this ON for debug mode (on SDK shows dbg_log messages)" OFF)

ADD_DEFINITIONS( -DDBG_FNCTRACE -DIN3_EXIT_SYSTEMRESET)


IF(USB_DONGLE)
  SET(BOARD nrf52840_pca10059)
  ADD_DEFINITIONS(-DUSB_DONGLE)
ELSE()
  SET(BOARD nrf52840_pca10056)
ENDIF()

IF(BT_MAC)
  ADD_DEFINITIONS(-DBT_MAC)
ENDIF()

IF(DEBUG)
  ADD_DEFINITIONS(-DDEBUG)
  SET(CMAKE_BUILD_TYPE Debug)
ENDIF()
#######################################################

# next line removes the >"unused parameter" warning when compiling
ADD_DEFINITIONS(-Wno-unused-parameter)

include($ENV{ZEPHYR_BASE}/cmake/app/boilerplate.cmake NO_POLICY_SCOPE)
project(NONE)

set_property(GLOBAL PROPERTY C_STANDARD 99)

target_sources(app PRIVATE
	src/main.c
	src/fsm.c
  src/meterReadings.c
  src/meterReadStorage.c
  src/fncWrapperHelper.c
  src/uart_comm.c
  src/in3_comm_esp32.c
  src/electricityMeter.c
)

# include core in the headers
include_directories ("${PROJECT_SOURCE_DIR}/../core")
include_directories ("${PROJECT_SOURCE_DIR}/../eth_full")
include_directories ("${PROJECT_SOURCE_DIR}/../eth_api")
include_directories ("${PROJECT_SOURCE_DIR}/../eth_nano")
include_directories ("${PROJECT_SOURCE_DIR}/../transport_curl")
include_directories ("${PROJECT_SOURCE_DIR}/../eth_basic")

# choose which module to include for LINKING
include("${PROJECT_SOURCE_DIR}/include_eth_core.cmake")
include("${PROJECT_SOURCE_DIR}/include_eth_nano.cmake")
include("${PROJECT_SOURCE_DIR}/include_eth_api.cmake")
include("${PROJECT_SOURCE_DIR}/include_eth_basic.cmake")
include(../core/compiler.cmake)

# add dependency
#add_subdirectory( ../core "${PROJECT_BINARY_DIR}/core")
#target_link_libraries(app core)
```

## prj.conf
```kconfig
# config console and stdout
#--------------------------
CONFIG_CONSOLE_SUBSYS=y
CONFIG_CONSOLE_GETCHAR=y
# CONFIG_STDOUT_CONSOLE=n#y
CONFIG_UART_CONSOLE=y
CONFIG_RTT_CONSOLE=n
CONFIG_PRINTK=n#y
# CONFIG_NEWLIB_LIBC=y    # to activate sscanf
CONFIG_NEWLIB_LIBC_FLOAT_PRINTF=y    #only starting from version 14

# CONFIG_SERIAL=y

# CONFIG_UART_CONSOLE=y
CONFIG_UART_INTERRUPT_DRIVEN=y
CONFIG_SERIAL_SUPPORT_INTERRUPT=y
CONFIG_STDOUT_CONSOLE=y


# config UART
#------------
CONFIG_UART_NRFX=y
CONFIG_UART_0_NRF_UART=y
CONFIG_UART_0_NRF_FLOW_CONTROL=n
# CONFIG_UART_INTERRUPT_DRIVEN=y

# config I/O
#-----------
CONFIG_GPIO=y
# NOTE: P0.09 and P0.10 usually set for NFC; to free them use next line
CONFIG_NFCT_PINS_AS_GPIOS=y

# config SPI
#-----------
CONFIG_SPI=y
CONFIG_SPI_NRFX=y
CONFIG_SPI_1=y
CONFIG_SPI_1_NRF_SPI=y

# config I2C
#-----------
CONFIG_I2C=y
CONFIG_I2C_NRFX=y
CONFIG_I2C_0=y
CONFIG_I2C_0_NRF_TWI=y

# config PWM
#-----------
CONFIG_PWM=y
CONFIG_PWM_NRF5_SW=y
CONFIG_PWM_NRF5_SW_0_CLOCK_PRESCALER=4

# config RTOS
#------------
CONFIG_HEAP_MEM_POOL_SIZE=131072
# CONFIG_HEAP_MEM_POOL_SIZE=98304
#CONFIG_MAIN_STACK_SIZE=8192
CONFIG_MAIN_STACK_SIZE=16348
CONFIG_SYSTEM_WORKQUEUE_STACK_SIZE=4096

# config flash
#-------------
#CONFIG_FLASH=y
#CONFIG_FLASH_PAGE_LAYOUT=y
#CONFIG_FLASH_MAP=y
#CONFIG_FCB=y
#CONFIG_SETTINGS=y
#CONFIG_SETTINGS_FCB=y

# config Bluetooth
#-----------------
CONFIG_BT_SETTINGS=n
# n means that state and configuration are NOT stored permanently
CONFIG_BT_DEBUG_LOG=n
# we don't need debug info for bluetooth (at least, I hope so)
CONFIG_BT_PRIVACY=n
# local privacy not enabled
CONFIG_BT_PERIPHERAL=y
# set LE Peripheral role support
CONFIG_BT_DEVICE_APPEARANCE=384
# 384 = BLE_APPEARANCE_GENERIC_REMOTE_CONTROL 
CONFIG_BT_DEVICE_NAME="in3-peripheral"
# default name if not changed by App
CONFIG_BT_DEVICE_NAME_DYNAMIC=y
# can change the BLE name dinamically (see bluetooth init in main.c)
CONFIG_BT_DEVICE_NAME_MAX=24
# max length allowed for the name 
CONFIG_BT_L2CAP_TX_MTU=247
# change max allowable MTU
# note: comment line (defaults to 23) to be compatible with Android 5

CONFIG_BT=y
CONFIG_BT_ATT_PREPARE_COUNT=2
CONFIG_BT_GATT_CLIENT=y
CONFIG_BT_L2CAP_DYNAMIC_CHANNEL=n
CONFIG_BT_TINYCRYPT_ECC=n
CONFIG_BT_ID_MAX=4
CONFIG_BT_RX_BUF_COUNT=10
CONFIG_BT_RX_BUF_LEN=258
CONFIG_BT_L2CAP_TX_MTU=247
CONFIG_BT_L2CAP_TX_FRAG_COUNT=6
CONFIG_BT_L2CAP_TX_BUF_COUNT=10
CONFIG_BT_CONN_TX_MAX=10
CONFIG_BT_ATT_PREPARE_COUNT=10
CONFIG_BT_ID_MAX=4
CONFIG_BT_CTLR_RX_BUFFERS=10
CONFIG_BT_CTLR_TX_BUFFERS=10
CONFIG_BT_CTLR_TX_BUFFER_SIZE=251
CONFIG_BT_CTLR_DATA_LENGTH_MAX=251
```

## src/main.c
```c
#include "project.h"

// defines:
//---------
#define ALLIN 1000 // uS pwm pulse for piston in
#define ALLOUT 1900 // uS pwm pulse for piston out
#define PERIOD 40000 // uS pwm period

// variables:
static struct bt_conn *default_conn = NULL;
static struct bt_gatt_ccc_cfg req_ccc_cfg[BT_GATT_CCC_MAX] = {};

struct device *ledpower; // green led (power)
struct device *ledstrip; // led strip (used as lamp)
struct device *lockpin; // lock out
struct device *gpio; // using blue led on usb board for testing
struct device *pwm_dev; // door servo driver
struct device *demoRled; // USB demo Rled
struct device *demoGled; // USB demo Gled
struct device *demoBled; // USB demo Bled
 
/*
static u8_t gbuff1[32768]; // test buffer -DEBUG ONLY-
static u8_t gbuff2[32768]; // test buffer -DEBUG ONLY-
static u8_t gbuff3[32768]; // test buffer -DEBUG ONLY-
static u8_t gbuff4[8192]; // test buffer -DEBUG ONLY-
*/

static u8_t recv_buf_static[512];
static u8_t req_buf[512];

static u8_t *recv_buf;
static u32_t b_off;
static u32_t total_len;

static u32_t start, end;
static struct in3_client *client;

/////////////////////////////
// callbacks for BT services:
//
static ssize_t read_req(struct bt_conn *conn, const struct bt_gatt_attr *attr, // callback from: BT_GATT_CHARACTERISTIC (req_char_uuid)
			void *buf, u16_t len, u16_t offset)
{
	const char *value = attr->user_data;
	u16_t value_len;

	dbg_log("<--- read req (len=%u ofs=%u)\n", len, offset);

	value_len = min(strlen(value), sizeof(req_buf)); // limit the length to req_buf size

	return bt_gatt_attr_read(conn, attr, buf, len, offset, value, value_len);
}

static ssize_t rx_data(struct bt_conn *conn, const struct bt_gatt_attr *attr,
			 const void *buf, u16_t len, u16_t offset,
			 u8_t flags)
{
	dbg_log("<--- len:%u\n", len);
	// if processing a message don't take new ones
	if (client->msg->ready)
		{
		dbg_log("<--- write req rejected (another message being processed)!!!\n");
		return BT_GATT_ERR(BT_ATT_ERR_WRITE_REQ_REJECTED);
		}
/*  EFnote: used only for printing the MTU -no effect on the program- 
	if (total_len == 0) {
		int mtu = bt_gatt_get_mtu(conn) - 3;
		dbg_log(" GATT MTU: %d, DATA_SIZE: %d len=%d\n", mtu+3, mtu, len);
	}
*/
	if (len == 0x8) { // check if it's the header for a long transmission
		char magic[17];
		char *header = (char *) buf;
/*	EFnote: refusing the packet may hang with wrong/short packets - remove -
		if (total_len > 0) {
			dbg_log("<--- Channel already open, dismissing new request\n");
			return BT_GATT_ERR(BT_ATT_ERR_WRITE_REQ_REJECTED);
		}
*/
		sprintf(magic, "%02x%02x%02x%02x%02x%02x%02x%02x", header[0], header[1],
			header[2], header[3], header[4], header[5], header[6], header[7]);
		if (header[0] == 0x69 && // ascii "in3c"
		    header[1] == 0x6e &&
		    header[2] == 0x33 &&
		    header[3] == 0x63) {
			dbg_log("<--- Magic: 0x%s\n", magic); // a fingerprint used to identify an header packet
			if (start_message(*((int *) buf+1)))
				{
				dbg_log("<--- offset error\n");
				return BT_GATT_ERR(BT_ATT_ERR_INVALID_OFFSET);
				}
			bluetooth_clear_req();
			return len;
		}
	}

	if(recv_buf == 0) // if no space allocated
		recv_buf = k_calloc(1, total_len);
	////////////////////////////////////////////////////

	memcpy(recv_buf + b_off, buf, len);
	b_off += len;

	if (b_off >= total_len) {
		end = k_uptime_get_32();
		process_msg();
	}

	return len;
}

static void req_ccc_cfg_changed(const struct bt_gatt_attr *attr, u16_t value) // Callback from: BT_GATT_CCC (req_ccc_cfg, req_ccc_cfg_changed)
{
	dbg_log("<--- value = %u\n", value);
}

// define an UUID for msg_svc (BT_GATT_PRIMARY_SERVICE)
static struct bt_uuid_128 msg_svc_uuid = BT_UUID_INIT_128(
	0x01, 0xde, 0xbc, 0x9a, 0x78, 0x56, 0x34, 0x12,
	0x78, 0x56, 0x34, 0x12, 0x78, 0x56, 0x34, 0x12);

// define an UUID for msg_char (BT_GATT_CHARACTERISTIC #1)
static const struct bt_uuid_128 msg_char_uuid = BT_UUID_INIT_128(
	0x02, 0xde, 0xbc, 0x9a, 0x78, 0x56, 0x34, 0x12,
	0x78, 0x56, 0x34, 0x12, 0x78, 0x56, 0x34, 0x12);

// define an UUID for req_char (BT_GATT_CHARACTERISTIC #2)
static const struct bt_uuid_128 req_char_uuid = BT_UUID_INIT_128(
	0x02, 0xde, 0xbc, 0x9a, 0x78, 0x56, 0x34, 0x12,
	0x78, 0x56, 0x34, 0x12, 0x78, 0x56, 0x34, 0x13);

// define an UUID for notify (BT_GATT_CHARACTERISTIC #3)
static const struct bt_uuid_128 notify_uuid = BT_UUID_INIT_128(
	0x02, 0xde, 0xbc, 0x9a, 0x78, 0x56, 0x34, 0x12,
	0x78, 0x56, 0x34, 0x12, 0x78, 0x56, 0x34, 0x14);

static struct bt_gatt_attr msg_attrs[] = {
		BT_GATT_PRIMARY_SERVICE(&msg_svc_uuid), // [0] primary service

////////////////////////////////////////////////////////////////////////
		BT_GATT_CHARACTERISTIC(&msg_char_uuid.uuid, // [1] characteristic attribute uuid
			BT_GATT_CHRC_WRITE, // char att properties
			BT_GATT_PERM_WRITE | BT_GATT_PERM_PREPARE_WRITE, // char att permissions
			NULL, rx_data, recv_buf_static), // char att read callback, write callback, value

		BT_GATT_CHARACTERISTIC(&req_char_uuid.uuid, // [2] characteristic attribute uuid
			BT_GATT_CHRC_READ, // char att properties
			BT_GATT_PERM_READ, // char att permissions
			read_req, NULL, req_buf), // char att read callback, write callback, value

		BT_GATT_CHARACTERISTIC(&notify_uuid.uuid, // [3] characteristic attribute uuid
			BT_GATT_CHRC_NOTIFY, // char att properties
			BT_GATT_PERM_NONE, // char att permissions
			NULL, NULL, NULL), // char att read callback, write callback, value
////////////////////////////////////////////////////////////////////////

		BT_GATT_CCC(req_ccc_cfg, req_ccc_cfg_changed), // [4] initial config, callback to configuration change
};

////////
// Code:
//
int start_message(int size)
{
	u32_t old_len = total_len;
	total_len = size;
	dbg_log("RX Message (length: %lu bytes)\n", total_len);

	if (recv_buf && (old_len > total_len)) {
		memset(recv_buf, 0, total_len);
		goto out;
	}

	if (recv_buf)
		k_free(recv_buf);

	recv_buf = k_calloc(1, total_len * sizeof(char));

out:
	if (!recv_buf) {
		dbg_log("Error allocating RX buf (size=%lu)\n", total_len);
		return -1;
	}

	start = k_uptime_get_32();

	k_mutex_lock(&client->mutex, 5000);

	return 0;
}

void process_msg(void)
{
	client->msg->data = recv_buf;
	client->msg->size = total_len;

	client->msg->ready = 1;

	b_off = 0;
	total_len = 0;

	k_mutex_unlock(&client->mutex);
	in3_signal_event();
}

void clear_message(struct in3_client *c)
{
	// EFmod: in case of raw message received, msg->ready flag will NOT be reset
	//  and this may hang the program; so, do this anyway:
	dbg_log("<--- try to clear ready flag...\n");
	c->msg->ready = 0; // EFmod (check if it has been assigned previously)
	dbg_log("<--- ok\n");

	if (!recv_buf) {
		dbg_log("<--- recv_buf is empty; do not clear\n");
		return;
	}

	dbg_log("<--- try to free recv_buf...\n");
	k_free(recv_buf);
	dbg_log("<--- ok\n");

	dbg_log("<--- try to clear pointers...\n");
	c->msg->size = 0;
	c->msg->ready = 0;

	b_off = 0;
	total_len = 0;

	recv_buf = 0;
	c->msg->data = 0;
	dbg_log("<--- ok\n");
}

static struct bt_gatt_service msg_svc = BT_GATT_SERVICE(msg_attrs);

static const struct bt_data ad_discov[] = {
	BT_DATA_BYTES(BT_DATA_FLAGS, (BT_LE_AD_GENERAL | BT_LE_AD_NO_BREDR)),
};

static void connected(struct bt_conn *conn, u8_t err)
{
	dbg_log("<---\n"); // function is shown on the left
	default_conn = conn;
}

static void disconnected(struct bt_conn *conn, u8_t reason)
{
	dbg_log("<---\n"); // function is shown on the left
}

static bool le_param_req(struct bt_conn *conn, struct bt_le_conn_param *param)
{
int mtu = bt_gatt_get_mtu(conn);
	UNUSED_VAR(mtu);

	dbg_log("<--- req MTU=%d\n", mtu);
	return true;
}

static void le_param_updated(struct bt_conn *conn, u16_t interval, u16_t latency, u16_t timeout)
{
int mtu = bt_gatt_get_mtu(conn);
	UNUSED_VAR(mtu);

	dbg_log("<--- upd MTU=%d\n", mtu);
	return;
}

static struct bt_conn_cb conn_cbs = {
	.connected = connected,
	.disconnected = disconnected,
	.le_param_req = le_param_req,
	.le_param_updated = le_param_updated,
};

static void bt_ready(int err)
{
	default_conn = NULL;
	bt_conn_cb_register(&conn_cbs);
}

void bluetooth_write_req(char *msg)
{
	k_mutex_lock(&client->mutex, 5000);

	if (strlen(msg) > sizeof(recv_buf_static)) // EFmod: may be req_buf ?
		return;

	strcpy(req_buf, msg);
	dbg_log("<--- buffer prepared for req_char:\n%s\n", req_buf);

	k_mutex_unlock(&client->mutex);

	dbg_log("<--- try to send notification for REQ...\n");
	char *send = "REQ_READY";
//  EFmod: the "normal" [3] does not work. Index [5] is out of bounds, but it works...
//	bt_gatt_notify(NULL, &msg_attrs[3], send, strlen(send));
	bt_gatt_notify(NULL, &msg_attrs[5], send, strlen(send));
	dbg_log("<--- notify sent\n");
}

void bluetooth_clear_req(void)
{
//	dbg_log("<--- try to clear req_buf...\n");
	memset(req_buf, 0, sizeof(recv_buf_static)); // EFmod: may be sizeof(req_buf) ?
//	dbg_log("<--- req_buf zeroed (# %u bytes)\n", sizeof(recv_buf_static));
}

#ifdef BT_MAC // START block: next 3 functions needed only if hardcoded BT MAC is enabled
///////////////////////////////////////////////////////////////////////////////
static int char2hex(const char *c, u8_t *x)
{
	if (*c >= '0' && *c <= '9') {
		*x = *c - '0';
	} else if (*c >= 'a' && *c <= 'f') {
		*x = *c - 'a' + 10;
	} else if (*c >= 'A' && *c <= 'F') {
		*x = *c - 'A' + 10;
	} else {
		return -EINVAL;
	}

	return 0;
}

static int str2bt_addr(const char *str, bt_addr_t *addr)
{
	int i, j;
	u8_t tmp;

	if (strlen(str) != 17) {
		return -EINVAL;
	}

	for (i = 5, j = 1; *str != '\0'; str++, j++) {
		if (!(j % 3) && (*str != ':')) {
			return -EINVAL;
		} else if (*str == ':') {
			i--;
			continue;
		}

		addr->val[i] = addr->val[i] << 4;

		if (char2hex(str, &tmp) < 0) {
			return -EINVAL;
		}

		addr->val[i] |= tmp;
	}

	return 0;
}

static int str2bt_addr_le(const char *str, const char *type, bt_addr_le_t *addr)
{
	int err;

	err = str2bt_addr(str, &addr->a);
	if (err < 0) {
		return err;
	}

	if (!strcmp(type, "public") || !strcmp(type, "(public)")) {
		addr->type = BT_ADDR_LE_PUBLIC;
	} else if (!strcmp(type, "random") || !strcmp(type, "(random)")) {
		addr->type = BT_ADDR_LE_RANDOM;
	} else {
		return -EINVAL;
	}

	return 0;
}
#endif
///////////////////////////////////////////////////////////////////// END block

static void byte_to_hex(uint8_t b, char *s)
{
	s[0] = (b / 16) + '0'; // get high nibble, add ascii '0'
	if(s[0] > '9') s[0] += 7; // convert 10..15 to 'A'..'F' (+= 39 if 'a'..'f')
	s[1] = (b & 15) + '0'; // get low nibble, add ascii '0'
	if(s[1] > '9') s[1] += 7; // convert 10..15 to 'A'..'F' (+= 39 if 'a'..'f')
	s[2] = '\0'; // null terminate
}

int bluetooth_setup(struct in3_client *c)
{
	int err, lnam, fmac;
	size_t ad_len, scan_rsp_len = 0;
	struct bt_le_adv_param param;
	const struct bt_data *ad = 0, *scan_rsp = 0;
	char deviceName[24] = "in3-"; // look in prj.conf for max length

#ifdef BT_MAC // if enabled, hardcode the BT MAC address
	bt_addr_le_t addr;
//	char *c_addr = "d3:6c:29:4b:6b:45";
	char *c_addr = "c0:00:00:00:00:00"; // EFmod: most significative 2 bits must be 1
	char *c_addr_type = "(random)";
	err = str2bt_addr_le(c_addr, c_addr_type, &addr);
	bt_set_id_addr((const bt_addr_le_t *) &addr);
#endif

	err = bt_enable(bt_ready);
	if (err) {
		dbg_log("Unable to setup bluetooth");
		return -1;
	}

	k_sleep(1000);
//	bt_dev_show_info();

	param.id = 0;
	param.interval_min = BT_GAP_ADV_FAST_INT_MIN_2;
	param.interval_max = BT_GAP_ADV_FAST_INT_MAX_2;
	param.options = (BT_LE_ADV_OPT_CONNECTABLE |
				 BT_LE_ADV_OPT_USE_NAME);
	ad = ad_discov;
	ad_len = ARRAY_SIZE(ad_discov);

	if (IS_ENABLED(CONFIG_SETTINGS)) {
		settings_load();
	}

	fmac = NRF_FICR->DEVICEADDR[0]; // get low 4 octets of BT MAC
	lnam = strlen(deviceName); // original name length (before adding the MAC)
    byte_to_hex((fmac & 0xFF000000) >> 24, deviceName +lnam); // add MAC[3]
    byte_to_hex((fmac & 0xFF0000) >> 16, deviceName +lnam +2); // add MAC[2]
    byte_to_hex((fmac & 0xFF00) >> 8, deviceName +lnam +4); // add MAC[1]
    byte_to_hex(fmac & 0xFF, deviceName +lnam +6); // add MAC[0] (byte_to_hex adds \0)
//	bt_set_name(deviceName); // BT name built with "in3-" and NORDIC (almost) unique BT MAC (es: in3-84C8C54B)
//	bt_set_name("in3-peripheral"); // EFmod: the normal one
	bt_set_name("in3-emiliotest"); // EFmod: use ONLY this for testing with Arda's App

	err = bt_le_adv_start(&param, ad, ad_len, scan_rsp, scan_rsp_len);
	if (err < 0) {
		dbg_log("Failed to start advertising (err %d)\n", err);
		return -1;
	} else {
		dbg_log("Advertising started\n");
	}

	// set client data
	client = c;
	client->msg->data = recv_buf;

	recv_buf = 0;
	b_off = 0;
	total_len = 0;

	dbg_log("Registering GATT service\n");
	err = bt_gatt_service_register(&msg_svc);

	if (err < 0) {
		dbg_log("Failed to register servic\n");
		return -1;
	} else {
		dbg_log("Service registered\n");
	}

	return 0;
}

// GPIO functions //////////////////////////////////////////////////////
void ledpower_set(int state)
{
	if(state) // if ON
		gpio_pin_write(ledpower, LEDPOWER, 0); // led with negative logic
	else // if OFF
		gpio_pin_write(ledpower, LEDPOWER, 1); // led with negative logic
}

void ledstrip_set(int state)
{
	if(state) // if ON
		gpio_pin_write(ledstrip, LEDSTRIP, 1); // led with positive logic
	else { // if OFF
		gpio_pin_write(ledstrip, LEDSTRIP, 0); // led with positive logic OFF
		gpio_pin_write(demoGled, LEDG, 1); // negative logic, green led OFF
		gpio_pin_write(demoRled, LEDR, 1); // negative logic, red led OFF
	}
}

void lock_set(int state)
{
	if(state) // if ON
		gpio_pin_write(lockpin, LOCKPIN, 1); // coil with positive logic
	else // if OFF
		gpio_pin_write(lockpin, LOCKPIN, 0); // coil with positive logic
}

void door_control(int state) // control the motorized door 
{
	if(state == 'o') { // open door
		pwm_pin_set_usec(pwm_dev, DOORPIN, PERIOD, ALLOUT); // P0.2 - period,pulse; piston All-out
		gpio_pin_write(demoGled, LEDG, 0); // negative logic, green led ON
		return;
	}
	if(state == 'c') { // close door
		pwm_pin_set_usec(pwm_dev, DOORPIN, PERIOD, ALLIN); // P0.2 - period,pulse; piston All-in
		gpio_pin_write(demoRled, LEDR, 0); // negative logic, red led ON
		return;
	}
}

int gpio_setup(void)
{
	dbg_log("Init PWM...\n");
	pwm_dev = device_get_binding("PWM_0"); // try to bind PWM_0
	if (!pwm_dev) {
		dbg_log("Cannot find PWM_0 device!\n");
	} else {
		pwm_pin_set_usec(pwm_dev, DOORPIN, 40000, 1000); // P0.2 - 40mS period - 1mS pulse; piston All-in (door closed)
	}
	
	demoRled = device_get_binding(LEDR_PORT); // Rled is P0.08
	gpio_pin_configure(demoRled, LEDR, GPIO_DIR_OUT); // set as output (see fsm.h)
	gpio_pin_write(demoRled, LEDR, 0); // negative logic, led ON

	demoGled = device_get_binding(LEDG_PORT); // Gled is P1.09
	gpio_pin_configure(demoGled, LEDG, GPIO_DIR_OUT); // set as output (see fsm.h)
	gpio_pin_write(demoGled, LEDG, 0); // negative logic, led ON

	demoBled = device_get_binding(LEDB_PORT); // Gled is P0.12
	gpio_pin_configure(demoBled, LEDB, GPIO_DIR_OUT); // set as output (see fsm.h)
	gpio_pin_write(demoBled, LEDB, 0); // negative logic, led ON

	ledpower = device_get_binding(LEDPOWER_PORT); // CONFIG_GPIO_P0_DEV_NAME
	gpio_pin_configure(ledpower, LEDPOWER, GPIO_DIR_OUT); // set as output (see fsm.h)
	gpio_pin_write(ledpower, LEDPOWER, 0); // negative logic, led ON
	
	ledstrip = device_get_binding(LEDSTRIP_PORT);
	gpio_pin_configure(ledstrip, LEDSTRIP, GPIO_DIR_OUT); // set as output (see fsm.h)
	gpio_pin_write(ledstrip, LEDSTRIP, 0); // positive logic, led stripe OFF

	lockpin = device_get_binding(LOCKPIN_PORT);
	gpio_pin_configure(lockpin, LOCKPIN, GPIO_DIR_OUT); // set as output (see fsm.h)
	gpio_pin_write(lockpin, LOCKPIN, 0); // positive logic, coil OFF

	for(int i = 0, cnt = 0; i < 5; i++, cnt++) // blink led and terminate ON
		{
		ledpower_set(cnt % 2);
		k_sleep(200);
		}
	gpio_pin_write(ledpower, LEDPOWER, 0); // negative logic, led ON
	gpio_pin_write(demoRled, LEDR, 1); // red led off
	gpio_pin_write(demoGled, LEDG, 1); // green led off
	gpio_pin_write(demoBled, LEDB, 1); // blue led off
	return 0;
}
/////////////////////// end of new GPIO functions

void main(void)
{
	dbg_log("\n\n\n\n\n***\n*** Starting in3_client...\n");
 	gpio_setup(); // setup the GPIO
/*
	memset(gbuff1, 0x55, 32768); // fill buffer with 0x55
	dbg_log("Buff1 set...\n");
	memset(gbuff2, 0x55, 32768); // fill buffer with 0x55
	dbg_log("Buff2 set...\n");
	memset(gbuff3, 0x55, 32768); // fill buffer with 0x55
	dbg_log("Buff3 set...\n");
	memset(gbuff4, 0x55, 8192); // fill buffer with 0x55
	dbg_log("Buff4 set...\n");
*/
	in3_client_start();
	return;
}
```

## src/electricityMeter.c
```c
#include "electricityMeter.h"
#include <string.h>
#include "in3_comm_esp32.h"

// fwd. decl.
static void ReadOut_Dummy(getReading_RSP_t* reading);


// ---

typedef void (*fncReadOut_t)(getReading_RSP_t* reading);

fncReadOut_t fncReadOut = in3_comm_esp32_Modbus_ReadOut;




getReading_RSP_t* electricityMeter_ReadOut(){

    static getReading_RSP_t readingRSP;
    memset(&readingRSP, 0, sizeof(readingRSP));

    // read from xyz (what is defined/set above)
    fncReadOut(&readingRSP);

    return &readingRSP;
}


static void ReadOut_Dummy(getReading_RSP_t* reading){
    if (reading){
        reading->nExecResult = 0; //ok
        strncpy(reading->readingEntry.timestampYYYYMMDDhhmmss, "1234567890", sizeof(reading->readingEntry.timestampYYYYMMDDhhmmss));
        reading->readingEntry.i32Voltage_mV = 1;
        reading->readingEntry.i32Current_mA = 2;
        reading->readingEntry.u32EnergyMeter_mWh = 3;
    }
}
```

## src/electricityMeter.h
```c
#include "meterReadingTypes.h"


#if !defined(_ELECTRICITYMETER_H_)
#define _ELECTRICITYMETER_H_

extern getReading_RSP_t* electricityMeter_ReadOut();

#endif // _ELECTRICITYMETER_H_
```

## src/fncWrapperHelper.c
```c
#include <stdlib.h>
#include <stdio.h>
#include <string.h>
#include <client/cache.h>
#include <client/client.h>
#include <eth_api.h>
#include <eth_full.h>
#include <evm.h>
#include <in3_curl.h>
#include <in3_storage.h>
#include <signer.h>
#include <inttypes.h>
#include <util/debug.h>
#include <util/utils.h>

#include <util/data.h>
#include "fncWrapperHelper.h"


// ##### hier weiter: welche includes? was zu exportieren? ####

call_request_t* prepare_tx(char* fn_sig, char* to, char* args, char* block_number, uint64_t gas, char* value) {
  call_request_t* req = parseSignature(fn_sig);
  if (req->in_data->type == A_TUPLE) {
    json_ctx_t* in_data = parse_json(args);
    if (set_data(req, in_data->result, req->in_data) < 0) { 
      dbg_log("Error: could not set the data"); 
    }
    free_json(in_data);
  }
  sb_t* params = sb_new("");
  sb_add_chars(params, "[{\"to\":\"");
  sb_add_chars(params, to);
  sb_add_chars(params, "\", \"data\":");
  sb_add_bytes(params, "", &req->call_data->b, 1, false);
  if (block_number) {
    sb_add_chars(params, "},\"");
    sb_add_chars(params, block_number);
    sb_add_chars(params, "\"]");
  } else {
    if (value) {
      sb_add_chars(params, ", \"value\":\"");
      sb_add_chars(params, value);
      sb_add_chars(params, "\"");
    }
    sb_add_chars(params, ", \"gasLimit\":");
    uint8_t gasdata[8];
    bytes_t g_bytes = bytes(gasdata, 8);
    long_to_bytes(gas ? gas : 100000, gasdata);
    b_optimize_len(&g_bytes);
    sb_add_bytes(params, "", &g_bytes, 1, false);
    sb_add_chars(params, "}]");
  }
  strcpy(args, params->data);
  sb_free(params);
  return req;
}

void extract_vals(d_token_t* t, CB_extractVal_t pFncCB, void* pUserData) {
  char buf[65];
  memset(buf, 0, sizeof(buf));
  switch (d_type(t)) {
    case T_ARRAY:
    case T_OBJECT:
      for (d_iterator_t it = d_iter(t); it.left; d_iter_next(&it))
        extract_vals(it.token, pFncCB, pUserData);
      break;
    case T_BOOLEAN:
      snprintX(buf, sizeof(buf),"%s", d_int(t) ? "true" : "false");
      pFncCB(buf, pUserData);
      break;
    case T_INTEGER:
      snprintX(buf, sizeof(buf)-1,"%i", d_int(t));
      pFncCB(buf, pUserData);
      break;
    case T_BYTES:
      if (t->len < 9) {
        // printk("### T_BYTES: %" PRId64 " - ",  d_long(t)); // does not work on nRF52
        char bufTmp[21];
        snprintX(buf, sizeof(buf)-1,"%s",u64tostr(d_long(t), bufTmp, sizeof(bufTmp)));
      } else {
        int pos = 0;
        snprintX(&buf[pos],3,"0x");
        pos += 2;
        for (int i = 0; i < (int)(t->len); i++) 
        {
          snprintX(&buf[pos],3,"%02x", t->data[i]);
          pos += 2;
        }
      }
      pFncCB(buf, pUserData);
      break;
    case T_NULL:
      snprintX(buf, sizeof(buf),"NULL");
      pFncCB(buf, pUserData);
      break;
    case T_STRING:
      snprintX(buf, sizeof(buf),"%s", d_string(t));
      pFncCB(buf, pUserData);
      break;
  }
}
```

## src/fncWrapperHelper.h
```c
#if !defined(_FNCWRAPPERHELPER_H_)
#define _FNCWRAPPERHELPER_H_

#include <abi.h>


typedef void (*CB_extractVal_t)(const char*, void* pUserData);
extern void extract_vals(d_token_t* t, CB_extractVal_t pFncCB, void* pUserData);
extern call_request_t* prepare_tx(char* fn_sig, char* to, char* args, char* block_number, uint64_t gas, char* value);


#endif // _FNCWRAPPERHELPER_H_
```

## src/fsm.c
```c
#include "project.h"
#include "../core/util/log.h"
#include <console.h>
#include <misc/byteorder.h>
#include "../eth_basic/eth_basic.h"
#include "uart_comm.h"
#include "in3_comm_esp32.h"
#include "meterReadStorage.h"
// #include "meterReadings.h"
#include "electricityMeter.h"


// Global Client
struct in3_client*  client;
struct k_timer *timer0, *timer1, *timer2, *timer3; // timer structures

// private
static void timer_expired(struct k_timer* work) {
  dbg_log("<--- timer0 expired\n");
  k_sem_give(&client->sem);
}

static void timer1_expired(struct k_timer *work) // one shot timer (monitor led)
{
  dbg_log("<--- timer1 expired\n");
	ledpower_set(IO_ON); // power led on
}

static void timer2_expired(struct k_timer *work) // one shot timer (led stripe)
{
  dbg_log("<--- timer2 expired\n");
	ledstrip_set(IO_OFF); // ledstrip off
}

static void timer3_expired(struct k_timer *work) // one shot timer (lock-coil)
{
  dbg_log("<--- timer3 expired\n");
	lock_set(IO_OFF); // lock off
}

static void wait_for_event(void) {
  if (!client)
    return;

// //  k_sem_take(&client->sem, 600000); // EFnote: 600000 mS = 600 sec = 10 min
//   dbg_log("<--- k_sem_take(&client->sem -- PRE\n");
//   k_sem_take(&client->sem, K_SECONDS(5)); // 60 sec = 1 min
//   dbg_log("<--- k_sem_take(&client->sem -- POST\n");
}

void print_MeterReading(getReading_RSP_t* pReadingResponse) {
  if (pReadingResponse != NULL) {
    if (pReadingResponse->nExecResult >= 0) {
      printk("\tTimeStp: %s\n", pReadingResponse->readingEntry.timestampYYYYMMDDhhmmss);
      printk("\tVoltage: %d mV\n", pReadingResponse->readingEntry.i32Voltage_mV);
      printk("\tCurrent: %d mA\n", pReadingResponse->readingEntry.i32Current_mA);
      printk("\tPower  : %d mW\n", pReadingResponse->readingEntry.u32Power_mW);
      printk("\tEnergy : %d mWh\n", pReadingResponse->readingEntry.u32EnergyMeter_mWh);
    } else {
      printk("\tAn error occured: id %d\n", pReadingResponse->nExecResult);
    }
  }
}

static uint64_t l_u64Cntr = 0;
char* getTimestamp_asString(){
  return in3_comm_esp32_getTimestamp();
}


static char buffer[1024];

typedef enum {
  AS_err = -1,
  AS_done = 0,
  AS_sendRequest,
  AS_start,
  AS_waitFor_Ready,
  AS_waitFor_OkConnected,
  AS_waitFor_Response,
  AS_sleep10s_before_waitForOkConnected,
  AS_callMeterReadings_getContractVersion,
  AS_callMeterReadings_getLastReading,
  AS_callMeterReadings_getLastUnverifiedReadingId,
  AS_callMeterReadings_verify,
  AS_readElectricityMeter,
  AS_callMeterReadings_addReading,
} enmActivityState_t;

// #define AS_AFTER_START  AS_sendRequest
#define AS_AFTER_START  AS_callMeterReadings_getContractVersion

volatile enmActivityState_t g_activityState = 0;

static unsigned char l_bReady = 0;
static int cntErr = 0;
static int32_t l_i32U = 0;
static int32_t l_i32I = 0;
static uint32_t l_u32P = 0;
static getReading_RSP_t* pElectricityMeterReading = NULL;
static uint32_t u32LastUnverifiedReadingId = 0;

// void do_action(action_type_t action)
void do_action()
{
  l_u64Cntr++;
  char bufTmp[21];
  printk("~M%s\n", u64tostr(l_u64Cntr, bufTmp, sizeof(bufTmp)));

  static u32_t timeOut = 0;
  // action
  switch (g_activityState)
  {
    case AS_start: // send request (and then wait for "OK connected")
      // printf("~[{\"jsonrpc\":\"2.0\",\"method\":\"eth_blockNumber\",\"params\":[]}]\n");
      cntErr = 0;
      resetReceiveData(buffer, sizeof(buffer));
      if (!l_bReady)
      {
        timeOut =  k_uptime_get_32() + 4000; // "in 7 sec"
        g_activityState = AS_waitFor_Ready;
      } else {
        g_activityState = AS_AFTER_START;
      }    
      break;
    case AS_waitFor_Ready:
    {
      
      int erg = receiveData(buffer, sizeof(buffer));
      switch (erg)
      {
        case -1: // err
          g_activityState = AS_err;
          printk("<-- err: while receiving data\n");
          break;
        case 1: // data complete
          if (isReceivedData_StartsWith("READY", buffer, sizeof(buffer))){
            l_bReady = 1;
            g_activityState = AS_AFTER_START;
          } else {
            printk("<-- err: received data not equal to READY: \"%s\"\n", &buffer[1]);
            g_activityState = AS_err;
          }
          return;
          break;
      
        default:
          dbg_log("no data received (%d)\n", erg);
          break;
      }

      u32_t now = k_uptime_get_32();
      if (    g_activityState == AS_waitFor_Ready
          &&  now >= timeOut)  // timeout; send again RESET-Cmd.
      {
        printk("~>H\n");
        timeOut = k_uptime_get_32() + 4000;
      } else {
        dbg_log("    now: %u\ntimeout: %u\n", now, timeOut);
      }
      k_sleep(800);    
    } break;
    case AS_callMeterReadings_getContractVersion:
    {
      getContractVersion_RSP_t* pContractVersion_RSP = NULL;
      pContractVersion_RSP = meterReadStorage_getContractVersion();
      if (pContractVersion_RSP != NULL) 
      {
        printk("Contract-version: %s\n", pContractVersion_RSP->strVersion);
      } else {
        printk("An error occured: id %d\n", pContractVersion_RSP->nExecResult);
      }
      g_activityState = AS_callMeterReadings_getLastReading;
      if (pContractVersion_RSP->nExecResult >= 0){
        // ok
        cntErr = 0;
      } else if (++cntErr % 5 == 0) { 
        // 5-times error ==> restart
        l_bReady = 0;
        printk("##### ---- AS_callMeterReadings_getContractVersion - starting after 5x ERR ---- #####\n");
        NVIC_SystemReset();
        g_activityState = AS_start;
      } else {
        printk("Error while AS_callMeterReadings_getContractVersion (cntErr = %d)\n", cntErr);
      }
    } break;
    case AS_callMeterReadings_getLastReading:
    {
      getReading_RSP_t* pReading_RSP = NULL;
      pReading_RSP = meterReadStorage_getLastReading();
      printk("Reading back from Chain:\n");
      print_MeterReading(pReading_RSP);

      if (    pReading_RSP != NULL 
          &&  pReading_RSP->nExecResult >= 0 ) 
      {
        // ok
        cntErr = 0;
        l_i32I = pReading_RSP->readingEntry.i32Current_mA;
        l_i32U = pReading_RSP->readingEntry.i32Voltage_mV;
        l_u32P = pReading_RSP->readingEntry.u32EnergyMeter_mWh;

        // g_activityState = AS_callMeterReadings_addReading;
        g_activityState = AS_readElectricityMeter;
      } else if (++cntErr % 5 == 0) { 
        // 5-times error ==> restart
        printk("##### ---- AS_callMeterReadings_getLastReading - restarting after 5x ERR ---- #####\n");
        l_bReady = 0;
        g_activityState = AS_start;
      } else {
        // error while reading values ... start cycle again with getContractVersion
        printk("Error while AS_callMeterReadings_getLastReading (cntErr = %d)\n", cntErr);
        g_activityState = AS_callMeterReadings_getContractVersion;
      }

    } break;
    case AS_readElectricityMeter:
    {
      printk("Reading Electricity Meter:\n");
      pElectricityMeterReading = electricityMeter_ReadOut();
      print_MeterReading(pElectricityMeterReading);
      if (    pElectricityMeterReading != NULL 
          &&  pElectricityMeterReading->nExecResult >= 0 ) 
      {
        g_activityState = AS_callMeterReadings_addReading;
      } else
      {
        // error while reading values ... start cycle again with getContractVersion
        printk("Error while AS_readElectricityMeter\n");
        g_activityState = AS_callMeterReadings_getContractVersion;
      }
      
    }break;
    case AS_callMeterReadings_addReading:
    {
      addReading_RSP_t *pAddReading_RSP = NULL; 
      pAddReading_RSP = meterReadStorage_addReading( pElectricityMeterReading->readingEntry.timestampYYYYMMDDhhmmss, 
                                                  pElectricityMeterReading->readingEntry.i32Voltage_mV, 
                                                  pElectricityMeterReading->readingEntry.i32Current_mA, 
                                                  pElectricityMeterReading->readingEntry.u32EnergyMeter_mWh 
                                                );

      g_activityState = AS_callMeterReadings_getLastUnverifiedReadingId;      

      if (    pAddReading_RSP != NULL 
          &&  pAddReading_RSP->nExecResult >= 0 ) 
      {
        // ok
        cntErr = 0;
      } else if (++cntErr % 5 == 0) { 
        // 5-times error ==> restart
        l_bReady = 0;
        g_activityState = AS_start;
        printk("##### ---- AS_callMeterReadings_addReading - starting after 5x ERR ---- #####\n");
        // NVC_SystemReset();
      } else {
        printk("Error while calling meterReadings_addReading (cntErr = %d)\n", cntErr);
      }

    }break;
    case AS_callMeterReadings_getLastUnverifiedReadingId:
    {
      getLastUnverifiedReadingId_RSP_t* pLastUnverifiedReadingId_RSP = NULL;
      pLastUnverifiedReadingId_RSP = meterReadStorage_getLastUnverifiedReadingId();

      g_activityState = AS_callMeterReadings_getContractVersion;      

      if (    pLastUnverifiedReadingId_RSP != NULL 
          &&  pLastUnverifiedReadingId_RSP->nExecResult >= 0 ) 
      { // ok
        cntErr = 0;
        int bUnverifiedReadingAvail = pLastUnverifiedReadingId_RSP->bUnverifiedReadingAvailable;
        
        if ( pLastUnverifiedReadingId_RSP->readingID <= u32LastUnverifiedReadingId )
        {
          bUnverifiedReadingAvail =  0;
        }

        if (bUnverifiedReadingAvail) 
        {
          u32LastUnverifiedReadingId  = pLastUnverifiedReadingId_RSP->readingID;
        }

        printk("#### meterReadStorage_getLastUnverifiedReadingId(): readingID = %d, do_verifiy = %d\n", u32LastUnverifiedReadingId, bUnverifiedReadingAvail);
        g_activityState = bUnverifiedReadingAvail ? AS_callMeterReadings_verify : AS_readElectricityMeter; //AS_callMeterReadings_getContractVersion;      
      } else if (++cntErr % 5 == 0) { 
        // 5-times error ==> restart
        l_bReady = 0;
        g_activityState = AS_start;
        printk("##### ---- AS_callMeterReadings_getLastUnverifiedReadingId - starting after 5x ERR ---- #####\n");
        // NVC_SystemReset();
      } else {
        printk("Error while calling meterReadStorage_getLastUnverifiedReadingId (cntErr = %d)\n", cntErr);
      }
    } break;
    case AS_callMeterReadings_verify:
    { // meterReadStorage_verify(uint32_t  _meterReadId)
      printk("#### AS_callMeterReadings_verify: verifying #%d\n", u32LastUnverifiedReadingId);
      int nExecResult = meterReadStorage_verify(u32LastUnverifiedReadingId);

      g_activityState = AS_callMeterReadings_getLastUnverifiedReadingId;      

      if ( nExecResult >= 0 ) 
      { // ok
        cntErr = 0;
        printk("#### AS_callMeterReadings_verify(): executed OK\n");
      } else if (++cntErr % 5 == 0) { 
        // 5-times error ==> restart
        l_bReady = 0;
        g_activityState = AS_start;
        printk("##### ----- AS_callMeterReadings_verify - restarting after 5x ERR ---- #####\n");
        // NVC_SystemReset();
      } else {
        printk("Error while AS_callMeterReadings_verify (cntErr = %d)\n", cntErr);
      }
    } break;
    case AS_sendRequest:
    {
      dbg_log("AS_sendRequest\n");
      resetReceiveData(buffer, sizeof(buffer));
      printk("~{\"jsonrpc\":\"2.0\",\"id\":1,\"method\":\"eth_call\",\"params\":[{\"from\":\"0x0000000000000000000000000000000000000000\",\"to\":\"0x5bed06b162100cfa567d103795ea55c9368b6c06\",\"data\":\"0x0087a7880000000000000000000000000000000000000000000000000000000000000005\",\"value\":\"0x0\",\"gas\":\"0x2dc6c0\"}]}\n");

      g_activityState = AS_waitFor_OkConnected;
      timeOut = k_uptime_get_32() + 10000;
    } break;
    case AS_waitFor_OkConnected:
    {
      dbg_log("AS_waitFor_OkConnected\n");

      int erg = receiveData(buffer, sizeof(buffer));
      switch (erg)
      {
        case -1: // err
          g_activityState = AS_err;
          dbg_log("<-- err: while receiving data\n");
          return;
          break;
        case 1: // data complete
          if (isReceivedData_StartsWith("OK connected", buffer, sizeof(buffer))){
            dbg_log("<-- ok: received data is OK connected\n");
            resetReceiveData(buffer, sizeof(buffer));      
            g_activityState = AS_waitFor_Response;
            timeOut = k_uptime_get_32() + 10000;
          } else {
            dbg_log("<-- err: received data not equal to OK connected: \"%s\"\n", &buffer[1]);
            g_activityState = AS_err;
          }
          return;
          break;
      
        default:
          break;
      }
      if (    g_activityState == AS_waitFor_OkConnected
          &&  k_uptime_get_32() >= timeOut)  // timeout;
      {
        printk("AS_waitFor_OkConnected timed out.\n");
        g_activityState = AS_err; // timeout
      }
      k_sleep(800);    
    } break;
    case AS_waitFor_Response: 
    {
      dbg_log("### AS_waitFor_Response\n");
      int erg = receiveData(buffer, sizeof(buffer));
      switch (erg)
      {
        case -1: // err
          g_activityState = AS_err;
          dbg_log("<-- err: while receiving data\n");
          return;
          break;
        case 1: // data complete
          // print result:
          printk("> RESULT:\n>");
          printk(&buffer[0]);
          printk("\n\n");
          g_activityState = AS_done;
          return;
          break;
      
        default:
          break;
      }
      if (    g_activityState == AS_waitFor_Response
          &&  k_uptime_get_32() >= timeOut)  // timeout;
      {
        printk("AS_waitFor_Response timed out.\n");
         g_activityState = AS_err; // timeout
      }
      k_sleep(800);    
    } break;
  
    default:
      k_sleep(800);    
      break;
  }

}
 

// PUBLIC API
void in3_signal_event(void) {
  if (!client)
    return;

  dbg_log("<--- signalling event\n");
  k_sem_give(&client->sem);
}

/////////////////////////////////////

/*******************/
/*  state machine  */
/*******************/

   typedef enum {
        STATE_INIT,
        STATE_WAITING,
        STATE_ACTION,
        STATE_RESET,
        STATE_TEST,
        STATE_MAX
    } in3_state_t;

    typedef in3_state_t in3_state_func_t(void);


static in3_state_t in3_init(void) {
	client = k_calloc(1, sizeof(struct in3_client));
	timer0 = k_calloc(1, sizeof(struct k_timer));
	timer1 = k_calloc(1, sizeof(struct k_timer)); // allocate 1 array element of K_timer size
	timer2 = k_calloc(1, sizeof(struct k_timer)); // allocate 1 array element of K_timer size
	timer3 = k_calloc(1, sizeof(struct k_timer)); // allocate 1 array element of K_timer size
  
  // console_init();
  uart0_init();

	client->in3 = in3_new();

  in3_log_set_quiet(0/*false*/);

	// client->in3->chainId = 0x044d; // Tobalaba
	client->in3->chainId = 0x12046; // Volta
	client->in3->requestCount = 1;
	client->in3->max_attempts=3;
  client->in3->cacheStorage = NULL;
  // g_c->cacheStorage = NULL;
  
  client->in3->proof = PROOF_NONE; //PROOF_STANDARD //proof_standard nur mit eth_full mgl!
  client->in3->use_http = true;

  client->in3->nodeLimit = 5;
  client->in3->autoUpdateList = 0;

  // g_c->transport = sendJsonRequest_serial;
  client->in3->transport = in3_comm_esp32_sendJsonRequestAndWait;


	client->txr = k_calloc(1, sizeof(in3_tx_receipt_t));
	client->msg = k_calloc(1, sizeof(in3_msg_t));

  // in3_cache_init(client->in3);
	in3_register_eth_basic();
	// in3_register_eth_nano();
	// bluetooth_setup(client);

  meterReadStorageSetIN3(client->in3);

	k_sem_init(&client->sem, 0, 1);
	k_mutex_init(&client->mutex);
	k_timer_init(timer0, timer_expired, NULL);
	k_timer_init(timer1, timer1_expired, NULL); // init timer, callback for expired, callback for stopped
	k_timer_init(timer2, timer2_expired, NULL); // init timer, callback for expired, callback for stopped
	k_timer_init(timer3, timer3_expired, NULL); // init timer, callback for expired, callback for stopped

	return STATE_WAITING;
}

static in3_state_t in3_waiting(void) {
  static int cntr = 0;
  cntr++;

  dbg_log("in3_waiting()\n");

  k_mutex_lock(&client->mutex, 10000);
  // do client-zeugs
  k_mutex_unlock(&client->mutex);
  wait_for_event();

  // do_action(LOCK .. UNLOCK .. ?);

  if (cntr & 0x01) {
    return STATE_WAITING;
  } else {
    dbg_log("returning \"STATE_ACTION\"\n");
    return STATE_ACTION;
  }
}

static in3_state_t in3_action(void) {
  // dbg_log("<--- before msg_get_action(..)\n");
  // action_type_t action = msg_get_action(client->msg->data);
  // dbg_log("<--- after msg_get_action(..)\n");
  if (g_activityState <= AS_done) {
    if (g_activityState == AS_err)
    {
      l_bReady = 0; // Reset the ESP32 and wait for "READY"
    }
    g_activityState = AS_start;
  	ledpower_set(IO_OFF); // power led off
  }
  
  do_action(); // changes global variable g_activityState

  if (g_activityState <= AS_done) {
  	ledpower_set(IO_ON); // power led on
    return STATE_WAITING;
  }

  return STATE_ACTION;
}

static in3_state_t in3_reset(void) {
  client->msg->end = k_uptime_get_32();

  // dbg_log("<--- Total time: %lums\n", (unsigned long) client->msg->end - client->msg->start);
  clear_message(client);

  return STATE_WAITING;
}


static void in3_TEST_init(void) {
  printk("in3_TEST_init\n");
  uart0_init();
}

static unsigned int cntr_TEST=0;
static in3_state_t in3_TEST(void) {
  ledpower_set(IO_ON); // power led on
  k_sleep(1000);

//   uart_poll_in(struct device *dev, unsigned char *p_char);
  printk("printk -- cntr = %u\n", cntr_TEST++);

  // unsigned char zchn;
  // UartReadStatus_t readStatus = uart_getChar(&zchn);


  uart0_dumpBuffer();
  extern int l_nNumDataPackets;

  int nLen = uart0_getNextDataSize();
  printk("l_nNumDataPackets: %d, SzNextData: %d\n",l_nNumDataPackets, nLen);
  if (nLen >= 0){
    int szBuf = nLen+1;
    unsigned char *pBuf = k_malloc(nLen+1);
    uart0_getNextData(pBuf, szBuf);
    printk("Found data: %s\n", pBuf);
    k_free(pBuf);
  }

  ledpower_set(IO_OFF); // power led on
  k_sleep(1000);


  return STATE_TEST;
}


in3_state_func_t* const state_table[STATE_MAX] = {
    in3_init,
    in3_waiting,
    in3_action,
    in3_reset,
    in3_TEST,
    NULL
  };

static in3_state_t run_state(in3_state_t state) {
  return state_table[state]();
}

// #define __MY_TEST__


int in3_client_start(void) {

  // in3_state_t state = STATE_TEST;
  in3_state_t state = STATE_INIT;
  in3_state_t state_prev = STATE_MAX;

  printk("in3_client_start\n");
  #ifdef __MY_TEST__
    in3_TEST_init();
  #endif

  // ledpower_set(IO_ON); // power led on
  // k_sleep(3000);
  // ledpower_set(IO_OFF); // power led offs
  // k_sleep(1000);
  // in3_TEST();
  printk("this was just a call to in3_TEST()\n");

  while (1) {
    if (state_prev != state)
    {
      switch(state)
      {
        case STATE_INIT:
          dbg_log("<--- INIT\n");
          break;
        case STATE_WAITING:
          dbg_log("<--- WAITING\n");
          break;
        case STATE_ACTION:
          dbg_log("<--- ACTION\n");
          break;
        case STATE_RESET:
          dbg_log("<--- RESET\n");
          break;
        default:
          dbg_log("<--- STATE MACHINE ERROR!\n");
          state = STATE_RESET; // force state to reset
          break;
      }
    }
    state_prev = state;
    #ifdef __MY_TEST__
      in3_TEST();
    #else
      state = run_state(state);
    #endif
  }
}
```

## src/in3_comm_esp32.h
```c
#include "../core/client/client.h"
#include "meterReadingTypes.h"

#if !defined(IN3_COMM_ESP32_H)
#define IN3_COMM_ESP32_H

// nrf52 asking esp32 (rs232/serial)
extern int in3_comm_esp32_sendJsonRequestAndWait(
                                    char** urls,
                                    int urls_len, 
                                    char* payload, 
                                    in3_response_t* result
                                );

extern void in3_comm_esp32_Modbus_ReadOut(getReading_RSP_t* reading);

extern char* in3_comm_esp32_getTimestamp();


#endif // IN3_COMM_ESP32_H
```

## src/meterReadStorage.h
```c
// meterReadStorage.h
#include <stdint.h>
#include "meterReadingTypes.h"

#if !defined(_METERREADSTORAGE_H_)
#define _METERREADSTORAGE_H_


  typedef struct
  {
    int nExecResult;
    char strVersion[50];
  } getContractVersion_RSP_t;

  extern void                               meterReadStorageSetIN3(in3_t* pIN3);
  extern getContractVersion_RSP_t*          meterReadStorage_getContractVersion();
  extern getReading_RSP_t*                  meterReadStorage_getLastReading();
  extern getReading_RSP_t*                  meterReadStorage_getReading(uint32_t ixReading);
  extern getLastUnverifiedReadingId_RSP_t*  meterReadStorage_getLastUnverifiedReadingId();
  extern int                                meterReadStorage_verify(uint32_t  _meterReadId); 
  extern addReading_RSP_t*                  meterReadStorage_addReading( // returns (uint _readingID)
                                                                char*     _timestampYYYYMMDDhhmmss,
                                                                int32_t   _voltage_mV,
                                                                int32_t   _current_mA,
                                                                uint32_t  _counter_mWh
                                                              );
      

#endif // _METERREADSTORAGE_H_
```

## src/meterReadingTypes.h
```c
#include <stdint.h>

#if !defined(_METERREADINGTYPES_H_)
#define _METERREADINGTYPES_H_

  typedef struct 
  {
    char      timestampYYYYMMDDhhmmss[15];
    int32_t   i32Voltage_mV;
    int32_t   i32Current_mA;
    uint32_t  u32Power_mW;
    uint32_t  u32EnergyMeter_mWh;
    uint32_t  u32ADC_14bit;
  }  readingEntry_t;

  typedef struct
  {
    int nExecResult;
    readingEntry_t  readingEntry;
  } getReading_RSP_t;

  typedef struct
  {
    int       nExecResult;
    uint32_t  readingID;
  } addReading_RSP_t;

  typedef struct
  {
    int       nExecResult;
    uint32_t  readingID;
    int       bUnverifiedReadingAvailable;
  } getLastUnverifiedReadingId_RSP_t;

#endif // _METERREADINGTYPES_H_
```

## src/meterReadings.h
```c
// meterReadings.h
#include <stdint.h>
#include "meterReadingTypes.h"

#if !defined(_METERREADINGS_H_)
#define _METERREADINGS_H_


  typedef struct
  {
    int nExecResult;
    char strVersion[50];
  } getContractVersion_RSP_t;

  extern void                         meterReadingsSetIN3(in3_t* pIN3);
  extern getContractVersion_RSP_t*    meterReadings_getContractVersion();
  extern getReading_RSP_t*            meterReadings_getLastReading();
  extern getReading_RSP_t*            meterReadings_getReading(uint32_t ixReading);
  extern addReading_RSP_t*            meterReadings_addReading( // returns (uint _readingID)
                                                                char*     _timestampYYYYMMDDhhmmss,
                                                                int32_t   _voltage_mV,
                                                                int32_t   _current_mA,
                                                                uint32_t  _counter_mWh
                                                              );
      

#endif // _METERREADINGS_H_
```
